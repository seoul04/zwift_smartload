## CMakeLists.txt
```
# SPDX-License-Identifier: Apache-2.0

cmake_minimum_required(VERSION 3.20.0)
find_package(Zephyr REQUIRED HINTS $ENV{ZEPHYR_BASE})
project(central_hr)

# Modular version
target_sources(app PRIVATE
    src/main.c
    src/ftms_control_point.c
    src/notification_handler.c
    src/device_manager.c
    src/gatt_discovery.c
    src/nvs_storage.c
    src/led_feedback.c
    src/ecg_stream.c
    src/serial_cmd.c
)

zephyr_library_include_directories(${ZEPHYR_BASE}/samples/bluetooth)

# Compile-time diagnostic: drop the Heart Rate Service (0x180D) subscription.
#
# The Movesense app's HrBridge subscribes /Component/MAX3000x/HeartRateData
# whenever a client enables 0x2A37, and the MAX3000x is the same AFE that
# produces /Meas/ECG. Measured on the host with the same sensor, ECG was clean
# in 5/5 trials with 0x2A37 left off and failed in 2/4 with it on, so this
# removes HR from the link entirely to see whether the dongle's stalls follow.
#
# Off by default: the Polar H10 has no other source of R-R, and the Movesense
# GSP /Meas/HR fallback is covered by the same switch because it is the same
# AFE consumer wearing a different path.
#
# Set it through the environment, not with -D:
#
#   HR_OFF=1 west build -b nrf52840dongle/nrf52840 -d build_hr_off
#
# This project builds with sysbuild, and a -DHR_OFF=ON is only recorded in the
# sysbuild cache, so it never reaches the application image's compilation - the
# build succeeds and silently produces an HR-on binary. An environment variable
# is inherited by the app's CMake process, so it does take effect. The configure
# step prints "HR_OFF: enabled" when it is picked up; if that line is missing,
# the build is an HR-on build whatever the command line said.
#
# Build in a separate directory (-d build_hr_off) so the HR-on baseline used
# for comparison is not overwritten.
if(HR_OFF OR "$ENV{HR_OFF}" STREQUAL "1")
    message(STATUS "HR_OFF: enabled - Heart Rate Service subscription disabled")
    zephyr_compile_definitions(HR_OFF=1)
endif()
```

## prj.conf
```kconfig
# Bluetooth configuration: central / GATT client only (sensors). Zwift gets the data from
# z_relay_server over the network, so the dongle no longer advertises.
CONFIG_BT=y
CONFIG_BT_CENTRAL=y
CONFIG_BT_SMP=y
CONFIG_BT_GATT_CLIENT=y
CONFIG_BT_MAX_CONN=3

# GATT client MTU and ACL buffers.
# A Polar H10 PMD ECG frame is 229 bytes (10-byte header + 73 x 3-byte samples);
# a Movesense GSP ECG frame is ~72 bytes. The previous ACL RX size of 69 truncated
# the Polar frames to 20 bytes without reporting an error anywhere.
CONFIG_BT_GATT_AUTO_UPDATE_MTU=y
CONFIG_BT_GATT_AUTO_DISCOVER_CCC=y
CONFIG_BT_BUF_ACL_RX_SIZE=251
CONFIG_BT_BUF_ACL_TX_SIZE=251
# RX buffer count is BT_MAX_CONN + BT_BUF_ACL_RX_COUNT_EXTRA in this Zephyr; the
# old CONFIG_BT_BUF_ACL_RX_COUNT symbol no longer exists.
CONFIG_BT_BUF_ACL_RX_COUNT_EXTRA=3
CONFIG_BT_BUF_ACL_TX_COUNT=6
CONFIG_BT_L2CAP_TX_MTU=247

# Link robustness for a marginal-RF sensor.
#
# The Movesense was measured connected at -79 to -87 dBm, and the link was dying
# with HCI reason 0x08 (connection timeout) every few seconds. At -60 dBm the
# same firmware streamed 256 Hz continuously, so the drops are RF, not protocol.
#
# Transmit at the controller's maximum. The default is 0 dBm; the dongle sits in
# a USB port at floor level, so every dB of uplink matters for the ACKs that keep
# the sensor's supervision timer from expiring. +8 dBm is the nRF52840 radio's
# hardware ceiling - there is nothing higher available on this part.
CONFIG_BT_CTLR_TX_PWR_PLUS_8=y

# LE PHY: pinned to 1M.
#
# BT_PHY_UPDATE defaults to y in Zephyr, so BT_AUTO_PHY_UPDATE was initiating the
# PHY update procedure in every build - including the ones that measured well.
# Forcing 2M explicitly made things worse (9.05/s -> 3.04/s at a *better* RSSI of
# -52 dBm, with 240 of 600 seconds producing nothing), so the sensor does not
# cope with running its ECG measurement at 2M.
#
# Disabled outright rather than left at the default: with auto PHY update the
# link could move to 2M at any moment depending on what the peer proposes, which
# makes the stream behaviour depend on something we do not control.
CONFIG_BT_PHY_UPDATE=n
CONFIG_BT_CTLR_TX_PWR_PLUS_8=y

# Logging configuration
CONFIG_LOG=y
CONFIG_LOG_PRINTK=n
CONFIG_LOG_BUFFER_SIZE=4096
CONFIG_LOG_PROCESS_THREAD_SLEEP_MS=10

# Serial console: two directions. Outbound is the JSON record stream and the
# {"type":"info"} identity line; inbound is z_relay_server's commands, one JSON
# object per line ({"cmd":"ftms_cp","data":"..."}), read by an RX callback in
# serial_cmd.c. INTERRUPT_DRIVEN is what makes that callback possible.
CONFIG_SERIAL=y
CONFIG_UART_INTERRUPT_DRIVEN=y

# REQUIRED for inbound commands to arrive at all: the UDC packet pool must be
# big enough that the RX path can always get a buffer.
#
# The ECG stream writes a record every 8 ms and each record is copied into the
# TX ring buffer, so TX holds UDC buffers continuously. When
# cdc_acm_rx_fifo_handler() cannot allocate one it returns silently -- no log,
# no retry, no timer -- and the OUT endpoint is left un-armed forever. The host
# then sees its writes block and finally time out, which looks exactly like
# "the firmware ignores commands" even though the RX callback is registered and
# the poller runs. Verified on hardware: with CONFIG_UDC_BUF_COUNT=16 (default)
# RX never became ready; silencing the ECG stream made {"cmd":"info"} work.
#
# 64 buffers at USBD_MAX_BULK_MPS (64 B) is 4 KiB of pool for 64 B of packets.
CONFIG_UDC_BUF_COUNT=64
CONFIG_UDC_BUF_POOL_SIZE=4096

# REQUIRED: makes each printk() atomic with respect to preemption, so a JSON
# record cannot be cut in half.
#
# Without it, an ECG record (a header printf, 73 sample printf()s and a trailer,
# all under serial_output_mutex) can be split by another context's output. The
# mutex only orders this project's own callers; the split happens below it, in the
# console layer. Measured at roughly 1 torn record in 600, which breaks the trace
# for every following consumer because the line is no longer valid JSON.
#
# With it: 0 invalid records across 1,097 captured (976 ECG), and the dongle
# streams normally.
#
# Do NOT "fix" the tearing by assembling each record into a buffer and emitting it
# with a single printk(). That was tried and it left the dongle unresponsive after
# boot - LED dark, no BLE advertisements, no console output - while USB stayed
# enumerated. Keeping the separate printf()s and enabling this flag is both
# simpler and the only configuration verified to work.
#
# Default is "y" only on SMP; this board is uniprocessor, so it must be set here.
CONFIG_PRINTK_SYNC=y

# NOTE: CONFIG_ASSERT is deliberately left off. It only turns the GATT API's
# argument checks into __ASSERTs, and with CONFIG_RESET_ON_FATAL_ERROR disabled a
# failing assert halts the device instead of rebooting it, which leaves the dongle
# off the USB bus until it is physically replugged.

# GPIO for button input
CONFIG_GPIO=y

# Memory configuration
CONFIG_HEAP_MEM_POOL_SIZE=2048

# NVS (Non-Volatile Storage) for persistent device memory and grade limits
CONFIG_FLASH=y
CONFIG_FLASH_PAGE_LAYOUT=y
CONFIG_NVS=y

# Hardware information (for unique device ID)
CONFIG_HWINFO=y
```

## boards/raytac_mdbt50q_cx_40_dongle_nrf52840.conf
```kconfig
# Board-specific configuration for Raytac MDBT50Q-CX Dongle
# This board has Open DFU Bootloader at 0x0-0x1000

# Flash offset for bootloader
CONFIG_USE_DT_CODE_PARTITION=n
CONFIG_FLASH_LOAD_OFFSET=0x1000
```

## boards/nrf52840dongle_nrf52840.overlay
```dts
/* Device tree overlay for nRF52840 Dongle - use existing storage partition for NVS */

/ {
	chosen {
		/* Use the existing storage partition for NVS */
		zephyr,storage = &storage_partition;
	};
};

/* CDC ACM FIFOs. The defaults (1 KiB each) are too small: a full boot log with
 * service/characteristic discovery is longer than the TX FIFO, and the class
 * silently drops whatever does not fit. A full FIFO on the RX side also stops
 * the OUT transfer from being re-armed, which makes the host's writes time out. */
&board_cdc_acm_uart {
	tx-fifo-size = <16384>;
	rx-fifo-size = <4096>;
};
```

## boards/raytac_mdbt50q_cx_40_dongle_nrf52840.overlay
```dts
/* Device tree overlay for Raytac MDBT50Q-CX */

/ {
	chosen {
		/* Use the existing storage partition for NVS */
		zephyr,storage = &storage_partition;
	};
};

/* CDC ACM FIFOs. The defaults (1 KiB each) are too small: a full boot log with
 * service/characteristic discovery is longer than the TX FIFO, and the class
 * silently drops whatever does not fit. A full FIFO on the RX side also stops
 * the OUT transfer from being re-armed, which makes the host's writes time out. */
&board_cdc_acm_uart {
	tx-fifo-size = <16384>;
	rx-fifo-size = <4096>;
};
```

## src/main.c
```c
/* main.c - Application main entry point */

/*
 * Copyright (c) 2015-2016 Intel Corporation
 *
 * SPDX-License-Identifier: Apache-2.0
 */

#include <zephyr/kernel.h>
#include <zephyr/bluetooth/bluetooth.h>
#include <zephyr/bluetooth/conn.h>
#include <zephyr/bluetooth/gatt.h>
#include <zephyr/bluetooth/uuid.h>
#include <zephyr/bluetooth/hci.h>
#include <zephyr/sys/byteorder.h>
#include <zephyr/drivers/gpio.h>
#include <string.h>

#include "common.h"
#include "notification_handler.h"
#include "device_manager.h"
#include "gatt_discovery.h"
#include "nvs_storage.h"
#include "led_feedback.h"
#include "ecg_stream.h"
#include "serial_cmd.h"

/* Button configuration */
#define SW0_NODE DT_ALIAS(sw0)
static const struct gpio_dt_spec button = GPIO_DT_SPEC_GET(SW0_NODE, gpios);
static struct gpio_callback button_cb_data;

/* Button press tracking */
static uint32_t button_press_time = 0;
static struct k_work_delayable long_press_work;

/* Serial output mutex for thread-safe logging and JSON output */
K_MUTEX_DEFINE(serial_output_mutex);

/* Global variables */
struct conn_slot connections[MAX_CONNECTIONS];
uint32_t last_cp_data_time = 0;
uint64_t total_rx_count = 0;
char device_name_buffer[32] = DEVICE_NAME_PREFIX;
static uint32_t last_button_event_time = 0;  /* For debouncing */
#define BUTTON_DEBOUNCE_MS 100

/* Vendor-specific services.
 * UUID byte arrays are little-endian, i.e. the reverse of the printed form. */
const struct bt_uuid_128 pmd_service_uuid = BT_UUID_INIT_128(
	0xc8, 0xf0, 0x8d, 0x2d, 0xcd, 0x8a, 0xad, 0x1c,
	0x87, 0xf3, 0xe7, 0x02, 0x80, 0x5c, 0x00, 0xfb);

const struct bt_uuid_128 pmd_control_point_uuid = BT_UUID_INIT_128(
	0xc8, 0xf0, 0x8d, 0x2d, 0xcd, 0x8a, 0xad, 0x1c,
	0x87, 0xf3, 0xe7, 0x02, 0x81, 0x5c, 0x00, 0xfb);

const struct bt_uuid_128 pmd_data_uuid = BT_UUID_INIT_128(
	0xc8, 0xf0, 0x8d, 0x2d, 0xcd, 0x8a, 0xad, 0x1c,
	0x87, 0xf3, 0xe7, 0x02, 0x82, 0x5c, 0x00, 0xfb);

const struct bt_uuid_128 gsp_service_uuid = BT_UUID_INIT_128(
	0xf0, 0xe8, 0x50, 0x70, 0x0e, 0x63, 0x31, 0xb4,
	0x5d, 0x4d, 0x85, 0x71, 0x52, 0x22, 0x80, 0x34);

const struct bt_uuid_128 gsp_command_uuid = BT_UUID_INIT_128(
	0xf0, 0xe8, 0x50, 0x70, 0x0e, 0x63, 0x31, 0xb4,
	0x5d, 0x4d, 0x85, 0x71, 0x01, 0x00, 0x80, 0x34);

const struct bt_uuid_128 gsp_data_uuid = BT_UUID_INIT_128(
	0xf0, 0xe8, 0x50, 0x70, 0x0e, 0x63, 0x31, 0xb4,
	0x5d, 0x4d, 0x85, 0x71, 0x02, 0x00, 0x80, 0x34);

/* Services to discover */
const struct bt_uuid *discover_services[] = {
#ifndef HR_OFF
	BT_UUID_HRS,
#endif
	BT_UUID_CPS,
	BT_UUID_FMS,
	&gsp_service_uuid.uuid,
	&pmd_service_uuid.uuid,
};
const int discover_service_count = ARRAY_SIZE(discover_services);

static void connected(struct bt_conn *conn, uint8_t conn_err)
{
	char addr[BT_ADDR_LE_STR_LEN];

	bt_addr_le_to_str(bt_conn_get_dst(conn), addr, sizeof(addr));

	/* Find the connection slot */
	struct conn_slot *slot = NULL;
	int slot_idx = -1;
	for (int i = 0; i < MAX_CONNECTIONS; i++) {
		if (connections[i].conn == conn) {
			slot = &connections[i];
			slot_idx = i;
			break;
		}
	}

	if (!slot) {
		log("Connected but no slot found: %s\n", addr);
		return;
	}

	if (conn_err) {
		log("Failed to connect to %s (%u)\n", addr, conn_err);
		
		/* Cancel timeout if this was the pending connection */
		cancel_connection_timeout(conn);
		
		bt_conn_unref(slot->conn);
		slot->conn = NULL;
		start_scan();
		return;
	}

	log("Connected: %s\n", addr);

	/* MTU exchange runs right after the connection completes, so this is the
	 * pre-exchange value. The settled MTU is logged on the first notification. */
	slot->mtu_logged = false;
	log("Initial ATT MTU: %u\n", bt_gatt_get_mtu(conn));

	/* Update LED feedback for new connection */
	led_feedback_update();
	
	/* Copy RSSI from device_info (captured during scanning) */
	slot->rssi = 0;  /* Default if not found */
	struct device_info *dev_info;
	SYS_SLIST_FOR_EACH_CONTAINER(&device_list, dev_info, node) {
		if (!bt_addr_le_cmp(&dev_info->addr, bt_conn_get_dst(conn))) {
			slot->rssi = dev_info->rssi;
			log("RSSI at connection: %d dBm\n", slot->rssi);
			break;
		}
	}
	print_device_list();

	/* Cancel timeout if this was a pending connection */
	cancel_connection_timeout(conn);
	
	/* Save device to NVS for future reconnection priority */
	save_connected_device(conn);

	/* Log every service first, then run the targeted per-service discovery. */
	start_enumeration(conn, slot_idx);
}

static void disconnected(struct bt_conn *conn, uint8_t reason)
{
	char addr[BT_ADDR_LE_STR_LEN];

	bt_addr_le_to_str(bt_conn_get_dst(conn), addr, sizeof(addr));

	log("Disconnected: %s, reason 0x%02x %s\n", addr, reason, bt_hci_err_to_str(reason));

	/* Remove device from list so it can be cleanly re-discovered and re-connected */
	struct device_info *dev_info, *tmp;
	SYS_SLIST_FOR_EACH_CONTAINER_SAFE(&device_list, dev_info, tmp, node) {
		if (!bt_addr_le_cmp(&dev_info->addr, bt_conn_get_dst(conn))) {
			log("Removed device from list: %s\n", dev_info->name);
			sys_slist_find_and_remove(&device_list, &dev_info->node);
			k_free(dev_info);
			print_device_list();
			break;
		}
	}

	/* Find and clear the connection slot */
	bool found_slot = false;
	for (int i = 0; i < MAX_CONNECTIONS; i++) {
		if (connections[i].conn == conn) {
			log("Freeing connection slot %d (%d subscriptions)\n", 
			       i, connections[i].subscribe_count);
			
			/* Note: Don't call bt_gatt_unsubscribe here - connection is already
			 * disconnected so it fails with -ENOTCONN. The subscription params
			 * are cleared below and will be handled on next subscribe attempt. */
			
			/* Clear subscription state so params can be reused */
			connections[i].subscribe_count = 0;
			connections[i].cur_service = 0;
			/* Drop the ECG sample clock and any half-received GSP frame:
			 * a reconnect starts a new stream at a new time base. */
			ecg_stream_reset(&connections[i]);
			connections[i].hr_rr_misses = 0;
			
			bt_conn_unref(connections[i].conn);
			connections[i].conn = NULL;
			log("Freed connection slot %d\n", i);
			found_slot = true;
			
			/* Update LED feedback for disconnection */
			led_feedback_update();
			break;
		}
	}

	/* Cancel timeout if this was a pending connection */
	cancel_connection_timeout(conn);

	if (found_slot) {
		start_scan();
	}
}

BT_CONN_CB_DEFINE(conn_callbacks) = {
	.connected = connected,
	.disconnected = disconnected,
};

static void print_table_work_handler(struct k_work *work)
{
	log("Printing device list\n");
	print_device_list();
}

K_WORK_DEFINE(print_table_work, print_table_work_handler);

static void long_press_timeout_handler(struct k_work *work)
{
	/* Check if button is still pressed after 2 seconds */
	int button_state = gpio_pin_get_dt(&button);
	if (button_state == 1) {
		/* Button still pressed - it's a long press */
		log("Long button press detected - enabling scan window for 5 minutes\n");
		
		/* Disconnect all connected devices */
		disconnect_all_devices();
		
		/* Clear saved devices to start fresh pairing */
		nvs_clear_all_devices();
		log("Cleared all saved devices\n");
		
		start_scan_window(5 * 60 * 1000);  /* 5 minutes */
	}
}

static void button_pressed(const struct device *dev, struct gpio_callback *cb, uint32_t pins)
{
	uint32_t now = k_uptime_get_32();
	
	/* Debounce - ignore events within 100ms of last event */
	if ((now - last_button_event_time) < BUTTON_DEBOUNCE_MS) {
		return;
	}
	last_button_event_time = now;
	
	int button_state = gpio_pin_get_dt(&button);
	
	if (button_state == 1) {
		/* Button pressed */
		button_press_time = now;
		log("Button pressed\n");
		
		/* Schedule long press check after 2 seconds */
		k_work_reschedule_for_queue(&k_sys_work_q, &long_press_work, K_MSEC(2000));
	} else {
		/* Button released */
		uint32_t press_duration = k_uptime_get_32() - button_press_time;
		
		if (press_duration < 2000) {
			/* Short press - cancel long press work and print device list */
			k_work_cancel_delayable(&long_press_work);
			log("Short button press (%u ms) - printing device list\n", press_duration);
			k_work_submit(&print_table_work);
		}
		/* If long press, the timeout work already handled it */
	}
}

void announce_identity(void)
{
	bt_addr_le_t id_addrs[CONFIG_BT_ID_MAX];
	size_t id_count = ARRAY_SIZE(id_addrs);
	char id_addr[BT_ADDR_STR_LEN] = "";

	bt_id_get(id_addrs, &id_count);
	if (id_count > 0) {
		bt_addr_to_str(&id_addrs[0].a, id_addr, sizeof(id_addr));
	}
	json_out("{\"type\":\"info\",\"ts\":%u,\"name\":\"%s\",\"addr\":\"%s\",\"version\":\"%s\"}\n",
		 k_uptime_get_32(), device_name_buffer, id_addr, VERSION);
}

int main(void)
{
	int err;

	/* Delay to allow serial terminal to connect before first logs */
	k_sleep(K_SECONDS(5));

	err = bt_enable(NULL);

	if (err) {
		log("Bluetooth init failed (err %d)\n", err);
		return 0;
	}

	/* Initialize button */
	if (!gpio_is_ready_dt(&button)) {
		log("Button device not ready\n");
		return 0;
	}

	err = gpio_pin_configure_dt(&button, GPIO_INPUT);
	if (err < 0) {
		log("Failed to configure button (err %d)\n", err);
		return 0;
	}

	/* Initialize button press tracking work BEFORE configuring interrupt */
	k_work_init_delayable(&long_press_work, long_press_timeout_handler);

	err = gpio_pin_interrupt_configure_dt(&button, GPIO_INT_EDGE_BOTH);
	if (err < 0) {
		log("Failed to configure button interrupt (err %d)\n", err);
		return 0;
	}

	gpio_init_callback(&button_cb_data, button_pressed, BIT(button.pin));
	gpio_add_callback(button.port, &button_cb_data);
	log("Button initialized on pin %d\n", button.pin);

	/* Initialize modules */
	device_manager_init();
	ecg_stream_init();
	led_feedback_init();

	/* Commands from z_relay_server over the console, so Zwift's FTMS control
	 * point writes (grade, ERG) reach the trainer. Without this the server's
	 * write blocks against a CDC endpoint nobody drains and wedges its DirCon
	 * event loop. */
	int serial_err = serial_cmd_init();

	if (serial_err) {
		log("Serial command input unavailable (err %d); control point "
		    "writes from the server will not reach the trainer\n", serial_err);
	}

	/* Print initial device list */
	print_device_list();

	log("Central HR Sample Version %s\n", VERSION);

	/* Get device suffix and create full device name */
	char device_suffix[6];
	int suffix_result = nvs_get_device_suffix(device_suffix, sizeof(device_suffix));
	
	if (suffix_result == 0) {
		snprintf(device_name_buffer, sizeof(device_name_buffer), DEVICE_NAME_PREFIX "-%s", device_suffix);
	} else {
		strncpy(device_name_buffer, DEVICE_NAME_PREFIX, sizeof(device_name_buffer) - 1);
		device_name_buffer[sizeof(device_name_buffer) - 1] = '\0';
	}
	
	log("Bluetooth initialized as '%s'\n", device_name_buffer);

	/* Announce our identity on the console. z_relay_server uses the name and
	 * address to present the sensors to Zwift over DirCon. (This is the line
	 * the server reads; the console also carries commands the other way, see
	 * serial_cmd_init().) */
	announce_identity();

	log("Device ready - press button for 2+ seconds to enable scanning (5 min window)\n");
	return 0;
}
```

## src/common.h
```c
/* common.h - Shared definitions and structures */

#ifndef COMMON_H_
#define COMMON_H_

#include <zephyr/types.h>
#include <zephyr/bluetooth/bluetooth.h>
#include <zephyr/bluetooth/conn.h>
#include <zephyr/bluetooth/gatt.h>
#include <zephyr/sys/slist.h>
#include <zephyr/kernel.h>

/* Mutex for serial output synchronization */
extern struct k_mutex serial_output_mutex;

/* Define log macro using printf with timestamps - thread-safe */
#define log(fmt, ...) \
	do { \
		uint32_t _ms = k_uptime_get_32(); \
		k_mutex_lock(&serial_output_mutex, K_FOREVER); \
		printf("[%u.%u] " fmt, _ms / 1000, (_ms % 1000) / 100, ##__VA_ARGS__); \
		k_mutex_unlock(&serial_output_mutex); \
	} while(0)

/* Define json_out macro for JSON output - thread-safe */
#define json_out(fmt, ...) \
	do { \
		k_mutex_lock(&serial_output_mutex, K_FOREVER); \
		printf(fmt, ##__VA_ARGS__); \
		k_mutex_unlock(&serial_output_mutex); \
	} while(0)

/* Groups several json_out() calls into one contiguous record by holding the
 * output mutex across them. k_mutex is recursive, so the json_out() calls in
 * between re-take it safely. */
#define json_begin() k_mutex_lock(&serial_output_mutex, K_FOREVER)
#define json_end() k_mutex_unlock(&serial_output_mutex)

#define VERSION "1.21"

#define DEVICE_NAME_PREFIX "Z-Relay"

/* Dongle name reported to z_relay_server, e.g. "Z-Relay-3ED5" */
extern char device_name_buffer[32];

/* Print the {"type":"info"} identity record: the dongle's Bluetooth name,
 * address and version. Emitted once at boot and again whenever z_relay_server
 * asks with {"cmd":"info"}, so a server that starts after the dongle still
 * learns the identity instead of falling back to its own host address. */
void announce_identity(void);

#define MAX_CONNECTIONS 3  /* HR, Power Meter, Trainer */
/* Trainer needs: Indoor Bike Data, Training Status, Machine Status, Control Point.
 * An HR strap adds either a Polar PMD data subscription or a Movesense GSP one. */
#define MAX_SUBSCRIPTIONS_PER_CONN 7
#define MAX_SAVED_DEVICES 4

/* Largest ECG batch either strap sends in one frame (Polar H10 sends 73). */
#define ECG_MAX_SAMPLES 80

/* Room for one complete ECG record: header, ECG_MAX_SAMPLES signed samples, and
 * the trailer. A sample is at most "-2147483648" (11 chars) plus a separator, so
 * 80 * 12 + 64 header/trailer leaves comfortable headroom. */
#define ECG_RECORD_MAX (ECG_MAX_SAMPLES * 12 + 64)

/* GSP continuation buffer: one SBEM frame, comfortably above an ECG packet.
 * A notification carries at most ~20 samples at any supported rate, so the
 * frame size is set by the MTU, not by the sample rate. */
#define GSP_BUF_SIZE 200

/* What a subscription delivers, decided by the characteristic UUID rather than by
 * which service it came from: PMD and GSP each contribute characteristics from
 * inside a 128-bit service, so a service index cannot identify them. */
enum sub_kind {
	SUB_NONE = 0,
	SUB_HR_MEASUREMENT,      /* 0x2A37  HRS  */
	SUB_CP_MEASUREMENT,      /* 0x2A63  CPS  */
	SUB_FTMS_BIKE_DATA,      /* 0x2AD2  FTMS */
	SUB_FTMS_TRAINING,       /* 0x2AD3  FTMS */
	SUB_FTMS_STATUS,         /* 0x2ADA  FTMS */
	SUB_FTMS_CONTROL_POINT,  /* 0x2AD9  FTMS, indicate */
	SUB_POLAR_PMD_DATA,      /* FB005C82-02E7-F387-1CAD-8ACD2D8DF0C8 */
	SUB_MOVESENSE_GSP_DATA,  /* 34800002-7185-4d5d-b431-630e7050e8f0 */
	SUB_POLAR_PMD_CONTROL,   /* FB005C81-02E7-F387-1CAD-8ACD2D8DF0C8, indicate */
};

/* One primary service found by the enumeration walk. */
#define ENUM_MAX_SERVICES 12
#define ENUM_MAX_CHRCS 8

struct enum_svc_entry {
	uint16_t start_handle;
	uint16_t end_handle;
	struct bt_uuid_128 uuid;
};

/* Saved device structure for NVS persistence */
struct saved_device {
	bt_addr_le_t addr;
	char name[32];
	uint8_t svc_mask;
	uint8_t valid;  /* 1 if slot contains valid data, 0 if empty */
};

/* Device info structure for tracking discovered devices */
struct device_info {
	sys_snode_t node;
	bt_addr_le_t addr;
	char name[32];
	uint32_t last_seen;
	uint8_t svc_mask;
	bool has_battery_service;
	int8_t battery_level;  /* -1 if unknown, else 0..100 */
	bool is_saved;  /* true if this device was previously saved */
	int8_t rssi;    /* Last observed RSSI from scanning */
	bool role_skip_logged;
};

/* Connection slot structure */
struct conn_slot {
	struct bt_conn *conn;
	/* Points at a static UUID constant. It used to be an embedded bt_uuid_16,
	 * which memcpy truncated to 4 bytes and so could never match a 128-bit
	 * service. */
	const struct bt_uuid *discover_uuid;
	struct bt_gatt_discover_params discover_params;
	struct bt_gatt_subscribe_params subscribe_params[MAX_SUBSCRIPTIONS_PER_CONN];  /* Embedded storage */
	/* CONFIG_BT_GATT_AUTO_DISCOVER_CCC needs a discover_params pointer in each
	 * subscribe_params, plus a non-zero end_handle: bt_gatt_subscribe asserts on
	 * "end_handle && disc_params" and without them the CCC lookup returns
	 * -EINVAL. */
	struct bt_gatt_discover_params ccc_disc_params[MAX_SUBSCRIPTIONS_PER_CONN];
	/* Full primary-service walk (uuid == NULL) that runs before the targeted
	 * per-service discovery. It uses READ_BY_GROUP_TYPE, so unlike the filtered
	 * FIND_TYPE walk it cannot be confused with an ATT error response. */
	struct bt_gatt_discover_params enum_params;
	uint8_t enum_active;
	int enum_count;
	/* Services seen by the walk, so their characteristics can be dumped after. */
	struct enum_svc_entry enum_svcs[ENUM_MAX_SERVICES];
	int enum_svc_count;
	int enum_svc_idx;
	struct bt_gatt_discover_params enum_chrc_params;
	enum sub_kind sub_kind[MAX_SUBSCRIPTIONS_PER_CONN];
	int subscribe_count;
	int discover_service_index;  /* index into discover_services[] */
	int cur_service;             /* which service the characteristic walk is inside */
	uint16_t ftms_control_point_handle;
	uint16_t polar_pmd_cp_handle;   /* PMD control point: ECG start is written here */
	uint16_t movesense_cmd_handle;  /* GSP command characteristic */
	struct bt_gatt_write_params write_params;
	uint8_t gsp_ref_ecg;            /* GSP client reference for the ECG stream */
	uint8_t gsp_ref_hr;             /* GSP client reference for /Meas/HR */
	/* References from the previous connection. Kept after a reset so the next
	 * connection can unsubscribe them; otherwise the sensor keeps streaming
	 * under the old reference for the life of its own session. */
	uint8_t gsp_ref_ecg_prev;
	uint8_t gsp_ref_hr_prev;
	uint8_t gsp_ecg_started;
	uint32_t ecg_dropped;           /* ECG records discarded when the console could not take them */
	/* Stream health counters, reported periodically by ecg_stream.c. They are
	 * deltas rather than lifetime totals so the health line shows the live
	 * rate; a stalled stream then reads as 0/s instead of an average that
	 * hides the stall. */
	uint32_t ecg_frames;            /* records emitted on this connection */
	uint32_t ecg_samples;           /* samples emitted on this connection */
	uint32_t ecg_last_frame_ms;     /* uptime of the last emitted record, 0 = none yet */
	uint32_t ecg_gap_ms_max;        /* largest silence between two records */
	/* Ingress counters. An emitted record can only be as trustworthy as the
	 * count of notifications behind it, and the two were indistinguishable
	 * while debugging: a stalled stream and a stream whose records are being
	 * dropped on the way out both look like "the console went quiet". */
	uint32_t gsp_notifs;            /* GSP notifications received */
	uint32_t gsp_frames_done;       /* complete SBEM frames handed to the parser */
	uint32_t gsp_frames_unknown;    /* frames whose reference matched neither stream */
	/* Notifications of every kind on this slot. If GSP stops but HRS keeps
	 * arriving, the sensor ended the ECG measurement and the link is fine. If
	 * everything stops while the connection stays up, the host's receive path
	 * has stalled - the controller keeps the link alive on its own, so the two
	 * cases look identical from the outside without this counter. */
	uint32_t all_notifs;
	uint32_t hr_notifs;
	/* Watchdog state. The sensor ends the ECG measurement while the link stays
	 * up and HRS keeps notifying, so silence is indistinguishable from "the
	 * strap is off" unless the firmware remembers when it last covered the
	 * stream. Without a deadline nothing ever restarts it. */
	uint32_t ecg_start_ms;          /* uptime when the stream was requested */
	uint8_t gsp_restarts;           /* watchdog re-subscribes on this connection */
	/* Last GSP outcome, so the response handler can log what it was answering
	 * instead of a bare status with no provenance. */
	uint8_t gsp_last_cmd;           /* GSP_CMD_* of the last command written */
	uint8_t gsp_last_ref;           /* reference of the last command written */
	uint8_t gsp_unsub_status;       /* HTTP status of the last UNSUBSCRIBE, 0 = not answered */
	uint8_t gsp_conflict;           /* a SUBSCRIBE was refused with 409 on this connection */
	/* GSP DATA_PART2 reassembly */
	uint8_t gsp_buf[GSP_BUF_SIZE];
	uint16_t gsp_len;
	uint8_t gsp_ref;
	bool gsp_pending;
	/* ECG sample clock: anchored on the first packet, then advanced by the
	 * sample period so BLE arrival jitter never reaches the trace. */
	uint32_t ecg_t0_ms;
	uint16_t ecg_acc;       /* remainder of count*1000/fs_hz, carried between packets */
	uint8_t ecg_clock_valid;
	uint8_t hr_rr_misses;   /* consecutive HRS packets without RR, for the GSP fallback */
	uint8_t mtu_logged;
	struct bt_gatt_indicate_params indicate_params;
	uint16_t temp_value_handle;
	struct bt_uuid_16 battery_uuid;
	struct bt_gatt_discover_params battery_discover_params;
	struct bt_gatt_read_params battery_read_params;
	int8_t rssi;  /* Last known RSSI */
};

/* Global connection slots */
extern struct conn_slot connections[MAX_CONNECTIONS];

/* Vendor-specific services, needed for raw ECG. */
extern const struct bt_uuid_128 pmd_service_uuid;   /* Polar Measurement Data */
extern const struct bt_uuid_128 gsp_service_uuid;   /* Movesense GATT SensorData */

/* Polar PMD characteristics */
extern const struct bt_uuid_128 pmd_control_point_uuid;
extern const struct bt_uuid_128 pmd_data_uuid;

/* Movesense GSP characteristics */
extern const struct bt_uuid_128 gsp_command_uuid;
extern const struct bt_uuid_128 gsp_data_uuid;

/* Services to discover */
extern const struct bt_uuid *discover_services[];
extern const int discover_service_count;

/* Power meter tracking */
extern uint32_t last_cp_data_time;

/* Power meter crank counters, for cadence */
struct cp_cache {
	uint16_t cadence;  /* in 0.5 rpm units (same as FTMS) */
	uint16_t last_crank_revs;
	uint16_t last_crank_time;  /* sensor time in 1/1024 second units */
	uint32_t last_crank_change_time;  /* wall clock timestamp of last crank revolution change */
	bool valid;
};
extern struct cp_cache cached_cp_data;

/* Statistics */
extern uint64_t total_rx_count;

#endif /* COMMON_H_ */
```

## src/device_manager.c
```c
/* device_manager.c - Device list and scanning */

#include <zephyr/kernel.h>
#include <zephyr/bluetooth/bluetooth.h>
#include <zephyr/bluetooth/gap.h>
#include <zephyr/bluetooth/hci.h>
#include <zephyr/bluetooth/conn.h>
#include <zephyr/bluetooth/uuid.h>
#include <zephyr/sys/byteorder.h>
#include <string.h>
#include <stdio.h>
#include "common.h"
#include "device_manager.h"
#include "nvs_storage.h"
#include "led_feedback.h"
#include "ecg_stream.h"

sys_slist_t device_list;

/* Connection timeout work */
static struct k_work_delayable conn_timeout_work;
static struct bt_conn *pending_conn = NULL;

/* Scan window control - only scan during active window */
static bool scan_window_active = false;
static struct k_work_delayable scan_window_timeout;

void print_device_list(void)
{
	struct device_info *dev_info;
	char addr[BT_ADDR_LE_STR_LEN];
	uint32_t now = k_uptime_get_32();
	int count = 0;

	/* Count devices first */
	SYS_SLIST_FOR_EACH_CONTAINER(&device_list, dev_info, node) {
		count++;
	}

	json_begin();
	json_out("{\"type\":\"devices\",\"ts\":%u,\"count\":%d,\"list\":[", now, count);
	
	int idx = 0;
	SYS_SLIST_FOR_EACH_CONTAINER(&device_list, dev_info, node) {
		bool is_connected = false;
		for (int i = 0; i < MAX_CONNECTIONS; i++) {
			if (connections[i].conn) {
				const bt_addr_le_t *conn_addr = bt_conn_get_dst(connections[i].conn);
				if (!bt_addr_le_cmp(conn_addr, &dev_info->addr)) {
					is_connected = true;
					break;
				}
			}
		}
		bt_addr_le_to_str(&dev_info->addr, addr, sizeof(addr));
		json_out("{\"name\":\"%s\",\"addr\":\"%s\",\"connected\":%s,\"saved\":%s,\"battery_level\":",
		       dev_info->name, addr, is_connected ? "true" : "false", 
		       dev_info->is_saved ? "true" : "false");
		if (dev_info->battery_level >= 0) {
			json_out("%d", dev_info->battery_level);
		} else {
			json_out("null");
		}
		json_out(",\"last_seen\":%u}", dev_info->last_seen);
		if (idx < count - 1) {
			json_out(",");
		}
		idx++;
	}
	json_out("]}\n");
	json_end();
}

static void conn_timeout_handler(struct k_work *work)
{
	if (pending_conn) {
		char addr[BT_ADDR_LE_STR_LEN];
		bt_addr_le_to_str(bt_conn_get_dst(pending_conn), addr, sizeof(addr));
		log("Connection timeout to %s, cancelling...\n", addr);

		/* Drop the reference before asking for a disconnect, and clear
		 * pending_conn either way.
		 *
		 * This used to clear both only when bt_conn_disconnect() failed. On
		 * success pending_conn kept pointing at a connection that was being
		 * torn down, so it was never unref'd and stayed stale; and because the
		 * work was scheduled with k_work_schedule() it could fire again on a
		 * still-live connection, disconnecting devices that had connected
		 * perfectly well. On hardware that showed up as a disconnect/reconnect
		 * cycle every few seconds with reason 0x00 (local termination). */
		int err = bt_conn_disconnect(pending_conn, BT_HCI_ERR_REMOTE_USER_TERM_CONN);

		bt_conn_unref(pending_conn);
		pending_conn = NULL;

		if (err) {
			log("Failed to cancel connection (err %d)\n", err);
			start_scan();
		}
	}
}

void cancel_connection_timeout(struct bt_conn *conn)
{
	if (pending_conn && pending_conn == conn) {
		k_work_cancel_delayable(&conn_timeout_work);
		bt_conn_unref(pending_conn);
		pending_conn = NULL;
	}
}

/* One role per device (trainer > power meter > HR): trainers often also advertise CP */
static uint8_t primary_role(uint8_t svc_mask)
{
	if (svc_mask & 0x04) {
		return 0x04;
	}
	if (svc_mask & 0x02) {
		return 0x02;
	}
	return svc_mask & 0x01;
}

static struct device_info *find_device(const bt_addr_le_t *addr)
{
	struct device_info *dev_info;

	SYS_SLIST_FOR_EACH_CONTAINER(&device_list, dev_info, node) {
		if (!bt_addr_le_cmp(&dev_info->addr, addr)) {
			return dev_info;
		}
	}
	return NULL;
}

/* Roles already held by connected (or connecting) devices */
static uint8_t taken_roles(void)
{
	uint8_t roles = 0;

	for (int i = 0; i < MAX_CONNECTIONS; i++) {
		if (connections[i].conn) {
			struct device_info *dev = find_device(bt_conn_get_dst(connections[i].conn));
			if (dev) {
				roles |= primary_role(dev->svc_mask);
			}
		}
	}
	return roles;
}

static bool eir_found(struct bt_data *data, void *user_data)
{
	struct {
		const bt_addr_le_t *addr;
		char name[32];
		uint8_t svc_mask;
		bool has_battery_service;
	} *ctx = user_data;

	int i;

	switch (data->type) {
	case BT_DATA_UUID16_SOME:
	case BT_DATA_UUID16_ALL:
		if (data->data_len % sizeof(uint16_t) != 0U) {
			return true;
		}

		for (i = 0; i < data->data_len; i += sizeof(uint16_t)) {
			uint16_t u16;
			memcpy(&u16, &data->data[i], sizeof(u16));
			uint16_t uuid16 = sys_le16_to_cpu(u16);
			const struct bt_uuid *uuid = BT_UUID_DECLARE_16(uuid16);

			if (!bt_uuid_cmp(uuid, BT_UUID_HRS)) {
				ctx->svc_mask |= 0x01;
			} else if (!bt_uuid_cmp(uuid, BT_UUID_DECLARE_16(0x1818))) {
				ctx->svc_mask |= 0x02;
			} else if (!bt_uuid_cmp(uuid, BT_UUID_DECLARE_16(0x1826))) {
				ctx->svc_mask |= 0x04;
			} else if (uuid16 == 0x180F) {
				ctx->has_battery_service = true;
			}
		}
		break;
	case BT_DATA_NAME_COMPLETE:
	case BT_DATA_NAME_SHORTENED:
		{
			size_t len = data->data_len < sizeof(ctx->name) - 1 ? data->data_len : sizeof(ctx->name) - 1;
			memcpy(ctx->name, data->data, len);
			ctx->name[len] = '\0';
		}
		break;
	default:
		break;
	}

	return true;
}

static void device_found(const bt_addr_le_t *addr, int8_t rssi, uint8_t type,
			 struct net_buf_simple *ad)
{
	char dev[BT_ADDR_LE_STR_LEN];

	bt_addr_le_to_str(addr, dev, sizeof(dev));

	struct {
		const bt_addr_le_t *addr;
		char name[32];
		uint8_t svc_mask;
		bool has_battery_service;
	} parse_ctx;
	parse_ctx.addr = addr;
	parse_ctx.name[0] = '\0';
	parse_ctx.svc_mask = 0;
	parse_ctx.has_battery_service = false;

	bt_data_parse(ad, eir_found, &parse_ctx);

	/* Filter out other Z-Relay devices to avoid cross-connection */
	if (strncmp(parse_ctx.name, DEVICE_NAME_PREFIX, strlen(DEVICE_NAME_PREFIX)) == 0) {
		return;
	}

	uint32_t now = k_uptime_get_32();

	struct device_info *dev_info = NULL;
	struct device_info *iter;
	bool found = false;
	SYS_SLIST_FOR_EACH_CONTAINER(&device_list, iter, node) {
		if (!bt_addr_le_cmp(&iter->addr, addr)) {
			dev_info = iter;
			found = true;
			break;
		}
	}

	if (found && dev_info) {
		if (parse_ctx.name[0] != '\0' && strcmp(dev_info->name, parse_ctx.name) != 0) {
			bool was_address = (strcmp(dev_info->name, dev) == 0);
			strncpy(dev_info->name, parse_ctx.name, sizeof(dev_info->name) - 1);
			dev_info->name[sizeof(dev_info->name) - 1] = '\0';
			if (was_address) {
				log("Captured name for device: %s (%s)\n", dev_info->name, dev);
			}
		}
		dev_info->last_seen = now;
		dev_info->svc_mask |= parse_ctx.svc_mask;
		dev_info->has_battery_service = dev_info->has_battery_service || parse_ctx.has_battery_service;
		dev_info->rssi = rssi;  /* Update RSSI from latest advertisement */
		/* Check if device is saved */
		dev_info->is_saved = nvs_is_device_saved(&dev_info->addr);
	} else if (!found) {
		/* Only track saved devices, or any device during scan window */
		bool is_saved = nvs_is_device_saved(addr);
		
		/* Outside scan window: only track saved devices */
		if (!scan_window_active && !is_saved) {
			return;
		}
		
		/* During scan window: track devices with relevant services */
		if (scan_window_active && parse_ctx.svc_mask == 0 && !is_saved) {
			/* Skip devices without HR/CP/FTMS services */
			return;
		}
		
		dev_info = k_malloc(sizeof(struct device_info));
		if (dev_info) {
			memcpy(&dev_info->addr, addr, sizeof(bt_addr_le_t));
			if (parse_ctx.name[0] != '\0') {
				strncpy(dev_info->name, parse_ctx.name, sizeof(dev_info->name) - 1);
				dev_info->name[sizeof(dev_info->name) - 1] = '\0';
			} else {
				strncpy(dev_info->name, dev, sizeof(dev_info->name) - 1);
				dev_info->name[sizeof(dev_info->name) - 1] = '\0';
			}
			dev_info->svc_mask = parse_ctx.svc_mask;
			dev_info->has_battery_service = parse_ctx.has_battery_service;
			dev_info->battery_level = -1;
			dev_info->last_seen = now;
			dev_info->is_saved = is_saved;
			dev_info->role_skip_logged = false;
			dev_info->rssi = rssi;  /* Store RSSI from advertisement */
			sys_slist_append(&device_list, &dev_info->node);
			log("Added device: %s (svc_mask=%d, saved=%d)\n", dev_info->name, dev_info->svc_mask, is_saved);
			print_device_list();
		} else {
			log("ERROR: Failed to allocate memory for device %s\n", dev);
			return;
		}
	} else {
		log("ERROR: found=true but dev_info=NULL for %s\n", dev);
		return;
	}

	/* Attempt connection if device has known services */
	if (dev_info && dev_info->svc_mask != 0 && 
	    dev_info->name[0] != '\0' && strcmp(dev_info->name, dev) != 0) {
		
		/* Check if already connected first to avoid spam */
		bool already_connected = false;
		for (int i = 0; i < MAX_CONNECTIONS; i++) {
			if (connections[i].conn) {
				const bt_addr_le_t *conn_addr = bt_conn_get_dst(connections[i].conn);
				if (!bt_addr_le_cmp(conn_addr, addr)) {
					already_connected = true;
					break;
				}
			}
		}

		/* Saved devices can connect anytime; non-saved only during scan window */
		if (!already_connected && !dev_info->is_saved) {
			if (!scan_window_active) {
				/* Skip non-saved devices outside scan window */
				return;
			}
		}

		if (!already_connected && (taken_roles() & primary_role(dev_info->svc_mask))) {
			if (!dev_info->role_skip_logged) {
				log("Skipping %s: another device already provides its service\n", dev_info->name);
				dev_info->role_skip_logged = true;
			}
			return;
		}

		if (!already_connected) {
			int free_slot = -1;
			for (int i = 0; i < MAX_CONNECTIONS; i++) {
				if (!connections[i].conn) {
					free_slot = i;
					break;
				}
			}

			if (free_slot >= 0) {
				/* BT_LE_CONN_PARAM_DEFAULT uses a 30 ms interval and a
				 * short supervision timeout. On a marginal link (-80 dBm
				 * measured) that expires during momentary fades and tears
				 * the connection down with HCI reason 0x08, which also
				 * aborts the ECG stream mid-batch. Ask for the longest
				 * supervision timeout the spec allows (32 s) so short
				 * fades are ridden out instead of ending the session; the
				 * sensor may counter-propose, which the stack handles. */
				static struct bt_le_conn_param param = {
					.interval_min = 24,   /* 30 ms */
					.interval_max = 40,   /* 50 ms */
					.latency = 0,
					.timeout = 400,       /* 4 s supervision */
				};
				int err;

				/* Clear the slot to ensure clean state for new connection */
				memset(&connections[free_slot].subscribe_params, 0, 
				       sizeof(connections[free_slot].subscribe_params));
				memset(&connections[free_slot].ccc_disc_params, 0,
				       sizeof(connections[free_slot].ccc_disc_params));
				memset(&connections[free_slot].sub_kind, 0,
				       sizeof(connections[free_slot].sub_kind));
				connections[free_slot].subscribe_count = 0;
				connections[free_slot].discover_service_index = 0;
				connections[free_slot].ftms_control_point_handle = 0;
				connections[free_slot].polar_pmd_cp_handle = 0;
				connections[free_slot].movesense_cmd_handle = 0;
				connections[free_slot].temp_value_handle = 0;

				/* Reset the GSP subscribe state for the new connection.
				 * ecg_stream_reset() clears the current references and the
				 * step counter while preserving the previous ones, so the
				 * subscribe sequence can unsubscribe them first. It is safe
				 * to keep them even if a different device takes this slot:
				 * gsp_send_next() only runs for peers that expose the GSP
				 * command characteristic. */
				ecg_stream_reset(&connections[free_slot]);

				err = bt_le_scan_stop();
				if (err) {
					log("Stop LE scan failed (err %d)\n", err);
				} else {
					log("Creating connection to %s (slot %d)\n", dev_info->name, free_slot);
					struct bt_conn_le_create_param create_param = *BT_CONN_LE_CREATE_CONN;
					create_param.options = 0;
					
					err = bt_conn_le_create(&dev_info->addr, &create_param, &param, &connections[free_slot].conn);
					if (err) {
						log("Create connection failed (err %d)\n", err);
						connections[free_slot].conn = NULL;
						start_scan();
					} else {
						pending_conn = bt_conn_ref(connections[free_slot].conn);
						k_work_schedule(&conn_timeout_work, K_SECONDS(10));
					}
				}
			}
		}
	}

	/* Clean up old devices */
	struct device_info *next;
	SYS_SLIST_FOR_EACH_CONTAINER_SAFE(&device_list, dev_info, next, node) {
		bool is_connected = false;
		for (int i = 0; i < MAX_CONNECTIONS; i++) {
			if (connections[i].conn) {
				const bt_addr_le_t *conn_addr = bt_conn_get_dst(connections[i].conn);
				if (!bt_addr_le_cmp(conn_addr, &dev_info->addr)) {
					is_connected = true;
					dev_info->last_seen = now;
					break;
				}
			}
		}
		
		/* Remove devices not seen in 10 seconds, unless connected */
		if (now - dev_info->last_seen > 10000) {
			if (!is_connected) {
				log("Removed device: %s\n", dev_info->name);
				print_device_list();
				sys_slist_find_and_remove(&device_list, &dev_info->node);
				k_free(dev_info);
			}
		}
	}
}

static void _start_scan_internal(void)
{
	int err;

	struct bt_le_scan_param scan_param = {
		.type       = BT_LE_SCAN_TYPE_ACTIVE,
		.options    = BT_LE_SCAN_OPT_CODED,
		.interval   = BT_GAP_SCAN_FAST_INTERVAL,
		.window     = BT_GAP_SCAN_FAST_WINDOW,
	};

	err = bt_le_scan_start(&scan_param, device_found);
	if (err) {
		if (err == -EALREADY) {
			return;
		}
		log("Scanning with Coded PHY support failed (err %d)\n", err);

		log("Scanning without Coded PHY\n");
		scan_param.options &= ~BT_LE_SCAN_OPT_CODED;
		err = bt_le_scan_start(&scan_param, device_found);
		if (err && err != -EALREADY) {
			log("Scanning failed to start (err %d)\n", err);
			return;
		}
	}

	if (scan_window_active) {
		log("Scanning successfully started (window active)\n");
	} else {
		log("Scanning successfully started\n");
	}
}

void start_scan(void)
{
	_start_scan_internal();
}

static void scan_window_timeout_handler(struct k_work *work)
{
	log("Scan window expired - resuming normal scanning\n");
	scan_window_active = false;
	
	/* Update LED feedback for scan window end */
	led_feedback_update();
	
	/* Restart scanning to allow saved devices to reconnect normally */
	start_scan();
}

void start_scan_window(uint32_t duration_ms)
{
	scan_window_active = true;
	log("Scan window started for %u ms\n", duration_ms);
	
	/* Update LED feedback for scan window start */
	led_feedback_update();

	/* Schedule timeout to close window */
	k_work_reschedule_for_queue(&k_sys_work_q, &scan_window_timeout,
	                           K_MSEC(duration_ms));

	/* Start scanning immediately */
	_start_scan_internal();
}

void stop_scan_window(void)
{
	if (scan_window_active) {
		int err = bt_le_scan_stop();
		if (err && err != -EALREADY) {
			log("Failed to stop scan (err %d)\n", err);
		}
		k_work_cancel_delayable(&scan_window_timeout);
		scan_window_active = false;
		
		/* Update LED feedback for scan window stop */
		led_feedback_update();
		
		log("Scan window stopped\n");
	}
}

bool is_scan_window_active(void)
{
	return scan_window_active;
}

void disconnect_all_devices(void)
{
	for (int i = 0; i < MAX_CONNECTIONS; i++) {
		if (connections[i].conn) {
			char addr[BT_ADDR_LE_STR_LEN];
			bt_addr_le_to_str(bt_conn_get_dst(connections[i].conn), addr, sizeof(addr));
			log("Disconnecting device: %s\n", addr);
			bt_conn_disconnect(connections[i].conn, BT_HCI_ERR_REMOTE_USER_TERM_CONN);
		}
	}
}

void save_connected_device(struct bt_conn *conn)
{
	/* Find device in list */
	const bt_addr_le_t *addr = bt_conn_get_dst(conn);
	struct device_info *dev_info;
	
	SYS_SLIST_FOR_EACH_CONTAINER(&device_list, dev_info, node) {
		if (!bt_addr_le_cmp(&dev_info->addr, addr)) {
			/* Save device to NVS if not already saved */
			if (!dev_info->is_saved) {
				int err = nvs_save_device(&dev_info->addr, dev_info->name, dev_info->svc_mask);
				if (err == 0) {
					dev_info->is_saved = true;
					log("Auto-saved connected device: %s\n", dev_info->name);
				} else {
					log("Failed to save device %s (err %d)\n", dev_info->name, err);
				}
			}
			break;
		}
	}
}

void device_manager_init(void)
{
	sys_slist_init(&device_list);
	k_work_init_delayable(&conn_timeout_work, conn_timeout_handler);
	k_work_init_delayable(&scan_window_timeout, scan_window_timeout_handler);
	
	/* Initialize NVS storage */
	int err = nvs_storage_init();
	if (err) {
		log("Failed to initialize NVS storage (err %d)\n", err);
	} else {
		/* Load saved devices */
		struct saved_device saved[MAX_SAVED_DEVICES];
		int count = nvs_load_devices(saved, MAX_SAVED_DEVICES);
		log("Loaded %d saved device(s) from NVS\n", count);
		for (int i = 0; i < count; i++) {
			if (saved[i].valid) {
				char addr_str[BT_ADDR_LE_STR_LEN];
				bt_addr_le_to_str(&saved[i].addr, addr_str, sizeof(addr_str));
				log("  [%d] %s (%s) svc_mask=%d\n", i, saved[i].name, addr_str, saved[i].svc_mask);
			}
		}
	}
	
	/* Always start scanning - saved devices can reconnect anytime */
	start_scan();
}
```

## src/device_manager.h
```c
/* device_manager.h - Device list and scanning */

#ifndef DEVICE_MANAGER_H_
#define DEVICE_MANAGER_H_

#include <zephyr/bluetooth/bluetooth.h>

/* Device list */
extern sys_slist_t device_list;

/* Functions */
void device_manager_init(void);
void print_device_list(void);
void start_scan(void);
void cancel_connection_timeout(struct bt_conn *conn);
void save_connected_device(struct bt_conn *conn);

/* Scanning window control */
void start_scan_window(uint32_t duration_ms);
void stop_scan_window(void);
bool is_scan_window_active(void);

/* Disconnect all devices */
void disconnect_all_devices(void);

#endif /* DEVICE_MANAGER_H_ */
```

## src/ftms_control_point.h
```c
/* ftms_control_point.h - FTMS Control Point commands from z_relay_server, forwarded to the trainer */

#ifndef FTMS_CONTROL_POINT_H_
#define FTMS_CONTROL_POINT_H_

#include <zephyr/bluetooth/gatt.h>
#include <zephyr/bluetooth/conn.h>

/* FTMS Control Point Op Codes */
#define FTMS_CP_REQUEST_CONTROL           0x00
#define FTMS_CP_RESET                     0x01
#define FTMS_CP_SET_TARGET_SPEED          0x02
#define FTMS_CP_SET_TARGET_INCLINATION    0x03
#define FTMS_CP_SET_TARGET_RESISTANCE     0x04
#define FTMS_CP_SET_TARGET_POWER          0x05
#define FTMS_CP_SET_TARGET_HEARTRATE      0x06
#define FTMS_CP_START_RESUME              0x07
#define FTMS_CP_STOP_PAUSE                0x08
#define FTMS_CP_SET_INDOOR_BIKE_SIM       0x11
#define FTMS_CP_RESPONSE_CODE             0x80

/* FTMS Control Point result codes */
#define FTMS_CP_RESULT_SUCCESS            0x01
#define FTMS_CP_RESULT_NOT_SUPPORTED      0x02
#define FTMS_CP_RESULT_INVALID_PARAMETER  0x03
#define FTMS_CP_RESULT_FAILED             0x04

const char *ftms_cp_opcode_str(uint8_t opcode);

/* Convert (0x11 -> 0x04) and forward a Control Point command to the trainer.
 * Returns 0 if the write to the trainer was started, negative errno otherwise.
 * The trainer's response is printed as a "cp_resp" JSON line, and failures are
 * reported the same way with result FTMS_CP_RESULT_FAILED. */
int ftms_cp_handle_command(const uint8_t *cmd, uint16_t len);

/* Indication callback for Control Point responses from trainer */
uint8_t ftms_cp_indicate_func(struct bt_conn *conn,
			      struct bt_gatt_subscribe_params *params,
			      const void *data, uint16_t length);

#endif /* FTMS_CONTROL_POINT_H_ */
```
