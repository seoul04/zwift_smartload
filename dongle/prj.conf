## CMakeLists.txt
```
# SPDX-License-Identifier: Apache-2.0

cmake_minimum_required(VERSION 3.20.0)
find_package(Zephyr REQUIRED HINTS $ENV{ZEPHYR_BASE})
project(central_hr)

# Modular version
target_sources(app PRIVATE
    src/main.c
    src/gatt_services.c
    src/ftms_control_point.c
    src/notification_handler.c
    src/device_manager.c
    src/gatt_discovery.c
    src/nvs_storage.c
    src/led_feedback.c
)

zephyr_library_include_directories(${ZEPHYR_BASE}/samples/bluetooth)
```

## prj.conf
```kconfig
# Bluetooth configuration
CONFIG_BT=y
CONFIG_BT_CENTRAL=y
CONFIG_BT_PERIPHERAL=y
CONFIG_BT_BROADCASTER=y
CONFIG_BT_SMP=y
CONFIG_BT_GATT_CLIENT=y
CONFIG_BT_MAX_CONN=4

# Logging configuration
CONFIG_LOG=y
CONFIG_LOG_PRINTK=n
CONFIG_LOG_BUFFER_SIZE=4096
CONFIG_LOG_PROCESS_THREAD_SLEEP_MS=10

# GPIO for button input
CONFIG_GPIO=y

# Memory configuration
CONFIG_HEAP_MEM_POOL_SIZE=2048

# NVS (Non-Volatile Storage) for persistent device memory and grade limits
CONFIG_FLASH=y
CONFIG_FLASH_PAGE_LAYOUT=y
CONFIG_NVS=y

# Hardware information (for unique device ID)
CONFIG_HWINFO=y
```

## boards/raytac_mdbt50q_cx_40_dongle_nrf52840.conf
```kconfig
# Board-specific configuration for Raytac MDBT50Q-CX Dongle
# This board has Open DFU Bootloader at 0x0-0x1000

# Flash offset for bootloader
CONFIG_USE_DT_CODE_PARTITION=n
CONFIG_FLASH_LOAD_OFFSET=0x1000
```

## boards/nrf52840dongle_nrf52840.overlay
```dts
/* Device tree overlay for nRF52840 Dongle - use existing storage partition for NVS */

/ {
	chosen {
		/* Use the existing storage partition for NVS */
		zephyr,storage = &storage_partition;
	};
};

/* Increase CDC ACM TX buffer to accommodate full grade table JSON output (~2500 bytes) */
&board_cdc_acm_uart {
	tx-fifo-size = <4096>;
};
```

## boards/raytac_mdbt50q_cx_40_dongle_nrf52840.overlay
```dts
/* Device tree overlay for Raytac MDBT50Q-CX */

/ {
	chosen {
		/* Use the existing storage partition for NVS */
		zephyr,storage = &storage_partition;
	};
};

/* Increase CDC ACM TX buffer to accommodate full grade table JSON output (~2500 bytes) */
&board_cdc_acm_uart {
	tx-fifo-size = <4096>;
};
```

## src/main.c
```c
/* main.c - Application main entry point */

/*
 * Copyright (c) 2015-2016 Intel Corporation
 *
 * SPDX-License-Identifier: Apache-2.0
 */

#include <zephyr/kernel.h>
#include <zephyr/bluetooth/bluetooth.h>
#include <zephyr/bluetooth/conn.h>
#include <zephyr/bluetooth/gatt.h>
#include <zephyr/bluetooth/uuid.h>
#include <zephyr/bluetooth/hci.h>
#include <zephyr/sys/byteorder.h>
#include <zephyr/drivers/gpio.h>
#include <string.h>

#include "common.h"
#include "gatt_services.h"
#include "ftms_control_point.h"
#include "notification_handler.h"
#include "device_manager.h"
#include "gatt_discovery.h"
#include "nvs_storage.h"
#include "led_feedback.h"

/* Button configuration */
#define SW0_NODE DT_ALIAS(sw0)
static const struct gpio_dt_spec button = GPIO_DT_SPEC_GET(SW0_NODE, gpios);
static struct gpio_callback button_cb_data;

/* Button press tracking */
static uint32_t button_press_time = 0;
static struct k_work_delayable long_press_work;

/* Serial output mutex for thread-safe logging and JSON output */
K_MUTEX_DEFINE(serial_output_mutex);

/* Global variables */
struct conn_slot connections[MAX_CONNECTIONS];
struct bt_conn *peripheral_conn = NULL;
uint32_t last_cp_data_time = 0;
uint64_t total_rx_count = 0;
static char device_name_buffer[32] = DEVICE_NAME_PREFIX;  /* Store current device name for advertising callbacks */
static uint32_t last_button_event_time = 0;  /* For debouncing */
#define BUTTON_DEBOUNCE_MS 100

/* Services to discover */
const struct bt_uuid *discover_services[] = {
	BT_UUID_HRS,
	BT_UUID_CPS,
	BT_UUID_FMS,
};
const int discover_service_count = ARRAY_SIZE(discover_services);

static void connected(struct bt_conn *conn, uint8_t conn_err)
{
	char addr[BT_ADDR_LE_STR_LEN];

	bt_addr_le_to_str(bt_conn_get_dst(conn), addr, sizeof(addr));

	/* Find the connection slot */
	struct conn_slot *slot = NULL;
	int slot_idx = -1;
	for (int i = 0; i < MAX_CONNECTIONS; i++) {
		if (connections[i].conn == conn) {
			slot = &connections[i];
			slot_idx = i;
			break;
		}
	}

	if (!slot) {
		log("Connected but no slot found: %s\n", addr);
		return;
	}

	if (conn_err) {
		log("Failed to connect to %s (%u)\n", addr, conn_err);
		
		/* Cancel timeout if this was the pending connection */
		cancel_connection_timeout(conn);
		
		bt_conn_unref(slot->conn);
		slot->conn = NULL;
		start_scan();
		return;
	}

	log("Connected: %s\n", addr);
	
	/* Update LED feedback for new connection */
	led_feedback_update();
	
	/* Copy RSSI from device_info (captured during scanning) */
	slot->rssi = 0;  /* Default if not found */
	struct device_info *dev_info;
	SYS_SLIST_FOR_EACH_CONTAINER(&device_list, dev_info, node) {
		if (!bt_addr_le_cmp(&dev_info->addr, bt_conn_get_dst(conn))) {
			slot->rssi = dev_info->rssi;
			log("RSSI at connection: %d dBm\n", slot->rssi);
			break;
		}
	}
	print_device_list();

	/* Cancel timeout if this was a pending connection */
	cancel_connection_timeout(conn);
	
	/* Save device to NVS for future reconnection priority */
	save_connected_device(conn);

	/* Start discovery */
	start_discovery(conn, slot_idx);
}

static void disconnected(struct bt_conn *conn, uint8_t reason)
{
	char addr[BT_ADDR_LE_STR_LEN];

	bt_addr_le_to_str(bt_conn_get_dst(conn), addr, sizeof(addr));

	log("Disconnected: %s, reason 0x%02x %s\n", addr, reason, bt_hci_err_to_str(reason));

	/* Remove device from list so it can be cleanly re-discovered and re-connected */
	struct device_info *dev_info, *tmp;
	SYS_SLIST_FOR_EACH_CONTAINER_SAFE(&device_list, dev_info, tmp, node) {
		if (!bt_addr_le_cmp(&dev_info->addr, bt_conn_get_dst(conn))) {
			log("Removed device from list: %s\n", dev_info->name);
			sys_slist_find_and_remove(&device_list, &dev_info->node);
			k_free(dev_info);
			print_device_list();
			break;
		}
	}

	/* Find and clear the connection slot */
	bool found_slot = false;
	for (int i = 0; i < MAX_CONNECTIONS; i++) {
		if (connections[i].conn == conn) {
			log("Freeing connection slot %d (%d subscriptions)\n", 
			       i, connections[i].subscribe_count);
			
			/* Note: Don't call bt_gatt_unsubscribe here - connection is already
			 * disconnected so it fails with -ENOTCONN. The subscription params
			 * are cleared below and will be handled on next subscribe attempt. */
			
			/* Clear subscription state so params can be reused */
			connections[i].subscribe_count = 0;
			
			bt_conn_unref(connections[i].conn);
			connections[i].conn = NULL;
			log("Freed connection slot %d\n", i);
			found_slot = true;
			
			/* Update LED feedback for disconnection */
			led_feedback_update();
			break;
		}
	}

	/* Cancel timeout if this was a pending connection */
	cancel_connection_timeout(conn);

	if (found_slot) {
		/* Sensor disconnected */
		start_scan();
	} else {
		/* Peripheral disconnected */
		log("Peripheral disconnected, restarting advertising\n");
		
		if (peripheral_conn == conn) {
			bt_conn_unref(peripheral_conn);
			peripheral_conn = NULL;
			log("[FTMS CP] Cleared peripheral connection\n");
		}
		
		start_advertising(device_name_buffer);
	}
}

BT_CONN_CB_DEFINE(conn_callbacks) = {
	.connected = connected,
	.disconnected = disconnected,
};

static void print_table_work_handler(struct k_work *work)
{
	log("Printing device list\n");
	print_device_list();
}

K_WORK_DEFINE(print_table_work, print_table_work_handler);

static void long_press_timeout_handler(struct k_work *work)
{
	/* Check if button is still pressed after 2 seconds */
	int button_state = gpio_pin_get_dt(&button);
	if (button_state == 1) {
		/* Button still pressed - it's a long press */
		log("Long button press detected - enabling scan window for 5 minutes\n");
		
		/* Disconnect all connected devices */
		disconnect_all_devices();
		
		/* Clear saved devices to start fresh pairing */
		nvs_clear_all_devices();
		log("Cleared all saved devices\n");
		
		start_scan_window(5 * 60 * 1000);  /* 5 minutes */
	}
}

static void button_pressed(const struct device *dev, struct gpio_callback *cb, uint32_t pins)
{
	uint32_t now = k_uptime_get_32();
	
	/* Debounce - ignore events within 100ms of last event */
	if ((now - last_button_event_time) < BUTTON_DEBOUNCE_MS) {
		return;
	}
	last_button_event_time = now;
	
	int button_state = gpio_pin_get_dt(&button);
	
	if (button_state == 1) {
		/* Button pressed */
		button_press_time = now;
		log("Button pressed\n");
		
		/* Schedule long press check after 2 seconds */
		k_work_reschedule_for_queue(&k_sys_work_q, &long_press_work, K_MSEC(2000));
	} else {
		/* Button released */
		uint32_t press_duration = k_uptime_get_32() - button_press_time;
		
		if (press_duration < 2000) {
			/* Short press - cancel long press work and print device list */
			k_work_cancel_delayable(&long_press_work);
			log("Short button press (%u ms) - printing device list\n", press_duration);
			k_work_submit(&print_table_work);
		}
		/* If long press, the timeout work already handled it */
	}
}

int main(void)
{
	int err;

	/* Delay to allow serial terminal to connect before first logs */
	k_sleep(K_SECONDS(5));

	err = bt_enable(NULL);

	if (err) {
		log("Bluetooth init failed (err %d)\n", err);
		return 0;
	}

	/* Initialize button */
	if (!gpio_is_ready_dt(&button)) {
		log("Button device not ready\n");
		return 0;
	}

	err = gpio_pin_configure_dt(&button, GPIO_INPUT);
	if (err < 0) {
		log("Failed to configure button (err %d)\n", err);
		return 0;
	}

	/* Initialize button press tracking work BEFORE configuring interrupt */
	k_work_init_delayable(&long_press_work, long_press_timeout_handler);

	err = gpio_pin_interrupt_configure_dt(&button, GPIO_INT_EDGE_BOTH);
	if (err < 0) {
		log("Failed to configure button interrupt (err %d)\n", err);
		return 0;
	}

	gpio_init_callback(&button_cb_data, button_pressed, BIT(button.pin));
	gpio_add_callback(button.port, &button_cb_data);
	log("Button initialized on pin %d\n", button.pin);

	/* Initialize modules */
	device_manager_init();
	ftms_control_point_init();
	led_feedback_init();

	/* Print initial device list */
	print_device_list();

	log("Central HR Sample Version %s\n", VERSION);

	/* Get device suffix and create full device name */
	char device_suffix[6];
	int suffix_result = nvs_get_device_suffix(device_suffix, sizeof(device_suffix));
	
	if (suffix_result == 0) {
		snprintf(device_name_buffer, sizeof(device_name_buffer), DEVICE_NAME_PREFIX "-%s", device_suffix);
	} else {
		strncpy(device_name_buffer, DEVICE_NAME_PREFIX, sizeof(device_name_buffer) - 1);
		device_name_buffer[sizeof(device_name_buffer) - 1] = '\0';
	}
	
	bt_set_name(device_name_buffer);
	log("Bluetooth initialized as '%s'\n", device_name_buffer);

	start_advertising(device_name_buffer);
	log("Device ready - press button for 2+ seconds to enable scanning (5 min window)\n");
	return 0;
}
```

## src/common.h
```c
/* common.h - Shared definitions and structures */

#ifndef COMMON_H_
#define COMMON_H_

#include <zephyr/types.h>
#include <zephyr/bluetooth/bluetooth.h>
#include <zephyr/bluetooth/conn.h>
#include <zephyr/bluetooth/gatt.h>
#include <zephyr/sys/slist.h>
#include <zephyr/kernel.h>

/* Mutex for serial output synchronization */
extern struct k_mutex serial_output_mutex;

/* Define log macro using printf with timestamps - thread-safe */
#define log(fmt, ...) \
	do { \
		uint32_t _ms = k_uptime_get_32(); \
		k_mutex_lock(&serial_output_mutex, K_FOREVER); \
		printf("[%u.%u] " fmt, _ms / 1000, (_ms % 1000) / 100, ##__VA_ARGS__); \
		k_mutex_unlock(&serial_output_mutex); \
	} while(0)

/* Define json_out macro for JSON output - thread-safe */
#define json_out(fmt, ...) \
	do { \
		k_mutex_lock(&serial_output_mutex, K_FOREVER); \
		printf(fmt, ##__VA_ARGS__); \
		k_mutex_unlock(&serial_output_mutex); \
	} while(0)

#define VERSION "1.15"

#define DEVICE_NAME_PREFIX "Z-Relay"

#define MAX_CONNECTIONS 3  /* HR, Power Meter, Trainer */
#define MAX_SUBSCRIPTIONS_PER_CONN 5  /* Trainer needs: Indoor Bike Data, Training Status, Machine Status, Control Point */
#define MAX_SAVED_DEVICES 4

/* Saved device structure for NVS persistence */
struct saved_device {
	bt_addr_le_t addr;
	char name[32];
	uint8_t svc_mask;
	uint8_t valid;  /* 1 if slot contains valid data, 0 if empty */
};

/* Device info structure for tracking discovered devices */
struct device_info {
	sys_snode_t node;
	bt_addr_le_t addr;
	char name[32];
	uint32_t last_seen;
	uint8_t svc_mask;
	bool has_battery_service;
	int8_t battery_level;  /* -1 if unknown, else 0..100 */
	bool is_saved;  /* true if this device was previously saved */
	int8_t rssi;    /* Last observed RSSI from scanning */
};

/* Connection slot structure */
struct conn_slot {
	struct bt_conn *conn;
	struct bt_uuid_16 discover_uuid;
	struct bt_gatt_discover_params discover_params;
	struct bt_gatt_subscribe_params subscribe_params[MAX_SUBSCRIPTIONS_PER_CONN];  /* Embedded storage */
	int service_type[MAX_SUBSCRIPTIONS_PER_CONN]; /* 0=HR, 1=CP, 2=FTMS */
	int subscribe_count;
	int discover_service_index;
	uint16_t ftms_control_point_handle;
	struct bt_gatt_indicate_params indicate_params;
	uint16_t temp_value_handle;
	struct bt_uuid_16 battery_uuid;
	struct bt_gatt_discover_params battery_discover_params;
	struct bt_gatt_read_params battery_read_params;
	int8_t rssi;  /* Last known RSSI */
};

/* Global connection slots */
extern struct conn_slot connections[MAX_CONNECTIONS];

/* Peripheral (Zwift) connection */
extern struct bt_conn *peripheral_conn;

/* Services to discover */
extern const struct bt_uuid *discover_services[];
extern const int discover_service_count;

/* Power meter tracking */
extern uint32_t last_cp_data_time;
#define CP_TIMEOUT_MS 5000

/* Cached CP data for injection into FTMS */
struct cp_cache {
	int16_t power;
	uint16_t cadence;  /* in 0.5 rpm units (same as FTMS) */
	uint32_t timestamp;
	uint16_t last_crank_revs;
	uint16_t last_crank_time;  /* sensor time in 1/1024 second units */
	uint32_t last_crank_change_time;  /* wall clock timestamp of last crank revolution change */
	bool valid;
};
extern struct cp_cache cached_cp_data;

/* Statistics */
extern uint64_t total_rx_count;

#endif /* COMMON_H_ */
```

## src/device_manager.c
```c
/* device_manager.c - Device list and scanning */

#include <zephyr/kernel.h>
#include <zephyr/bluetooth/bluetooth.h>
#include <zephyr/bluetooth/gap.h>
#include <zephyr/bluetooth/hci.h>
#include <zephyr/bluetooth/conn.h>
#include <zephyr/bluetooth/uuid.h>
#include <zephyr/sys/byteorder.h>
#include <string.h>
#include <stdio.h>
#include "common.h"
#include "device_manager.h"
#include "nvs_storage.h"
#include "led_feedback.h"

sys_slist_t device_list;

/* Connection timeout work */
static struct k_work_delayable conn_timeout_work;
static struct bt_conn *pending_conn = NULL;

/* Scan window control - only scan during active window */
static bool scan_window_active = false;
static struct k_work_delayable scan_window_timeout;

void print_device_list(void)
{
	struct device_info *dev_info;
	char addr[BT_ADDR_LE_STR_LEN];
	uint32_t now = k_uptime_get_32();
	int count = 0;

	/* Count devices first */
	SYS_SLIST_FOR_EACH_CONTAINER(&device_list, dev_info, node) {
		count++;
	}

	json_out("{\"type\":\"devices\",\"ts\":%u,\"count\":%d,\"list\":[", now, count);
	
	int idx = 0;
	SYS_SLIST_FOR_EACH_CONTAINER(&device_list, dev_info, node) {
		bool is_connected = false;
		for (int i = 0; i < MAX_CONNECTIONS; i++) {
			if (connections[i].conn) {
				const bt_addr_le_t *conn_addr = bt_conn_get_dst(connections[i].conn);
				if (!bt_addr_le_cmp(conn_addr, &dev_info->addr)) {
					is_connected = true;
					break;
				}
			}
		}
		bt_addr_le_to_str(&dev_info->addr, addr, sizeof(addr));
		json_out("{\"name\":\"%s\",\"addr\":\"%s\",\"connected\":%s,\"saved\":%s,\"battery_level\":",
		       dev_info->name, addr, is_connected ? "true" : "false", 
		       dev_info->is_saved ? "true" : "false");
		if (dev_info->battery_level >= 0) {
			json_out("%d", dev_info->battery_level);
		} else {
			json_out("null");
		}
		json_out(",\"last_seen\":%u}", dev_info->last_seen);
		if (idx < count - 1) {
			json_out(",");
		}
		idx++;
	}
	json_out("]}\n");
}

static void conn_timeout_handler(struct k_work *work)
{
	if (pending_conn) {
		char addr[BT_ADDR_LE_STR_LEN];
		bt_addr_le_to_str(bt_conn_get_dst(pending_conn), addr, sizeof(addr));
		log("Connection timeout to %s, cancelling...\n", addr);
		
		int err = bt_conn_disconnect(pending_conn, BT_HCI_ERR_REMOTE_USER_TERM_CONN);
		if (err) {
			log("Failed to cancel connection (err %d)\n", err);
			bt_conn_unref(pending_conn);
			pending_conn = NULL;
			start_scan();
		}
	}
}

void cancel_connection_timeout(struct bt_conn *conn)
{
	if (pending_conn && pending_conn == conn) {
		k_work_cancel_delayable(&conn_timeout_work);
		bt_conn_unref(pending_conn);
		pending_conn = NULL;
	}
}

static bool eir_found(struct bt_data *data, void *user_data)
{
	struct {
		const bt_addr_le_t *addr;
		char name[32];
		uint8_t svc_mask;
		bool has_battery_service;
	} *ctx = user_data;

	int i;

	switch (data->type) {
	case BT_DATA_UUID16_SOME:
	case BT_DATA_UUID16_ALL:
		if (data->data_len % sizeof(uint16_t) != 0U) {
			return true;
		}

		for (i = 0; i < data->data_len; i += sizeof(uint16_t)) {
			uint16_t u16;
			memcpy(&u16, &data->data[i], sizeof(u16));
			uint16_t uuid16 = sys_le16_to_cpu(u16);
			const struct bt_uuid *uuid = BT_UUID_DECLARE_16(uuid16);

			if (!bt_uuid_cmp(uuid, BT_UUID_HRS)) {
				ctx->svc_mask |= 0x01;
			} else if (!bt_uuid_cmp(uuid, BT_UUID_DECLARE_16(0x1818))) {
				ctx->svc_mask |= 0x02;
			} else if (!bt_uuid_cmp(uuid, BT_UUID_DECLARE_16(0x1826))) {
				ctx->svc_mask |= 0x04;
			} else if (uuid16 == 0x180F) {
				ctx->has_battery_service = true;
			}
		}
		break;
	case BT_DATA_NAME_COMPLETE:
	case BT_DATA_NAME_SHORTENED:
		{
			size_t len = data->data_len < sizeof(ctx->name) - 1 ? data->data_len : sizeof(ctx->name) - 1;
			memcpy(ctx->name, data->data, len);
			ctx->name[len] = '\0';
		}
		break;
	default:
		break;
	}

	return true;
}

static void device_found(const bt_addr_le_t *addr, int8_t rssi, uint8_t type,
			 struct net_buf_simple *ad)
{
	char dev[BT_ADDR_LE_STR_LEN];

	bt_addr_le_to_str(addr, dev, sizeof(dev));

	struct {
		const bt_addr_le_t *addr;
		char name[32];
		uint8_t svc_mask;
		bool has_battery_service;
	} parse_ctx;
	parse_ctx.addr = addr;
	parse_ctx.name[0] = '\0';
	parse_ctx.svc_mask = 0;
	parse_ctx.has_battery_service = false;

	bt_data_parse(ad, eir_found, &parse_ctx);

	/* Filter out other Z-Relay devices to avoid cross-connection */
	if (strncmp(parse_ctx.name, DEVICE_NAME_PREFIX, strlen(DEVICE_NAME_PREFIX)) == 0) {
		return;
	}

	uint32_t now = k_uptime_get_32();

	struct device_info *dev_info = NULL;
	struct device_info *iter;
	bool found = false;
	SYS_SLIST_FOR_EACH_CONTAINER(&device_list, iter, node) {
		if (!bt_addr_le_cmp(&iter->addr, addr)) {
			dev_info = iter;
			found = true;
			break;
		}
	}

	if (found && dev_info) {
		if (parse_ctx.name[0] != '\0' && strcmp(dev_info->name, parse_ctx.name) != 0) {
			bool was_address = (strcmp(dev_info->name, dev) == 0);
			strncpy(dev_info->name, parse_ctx.name, sizeof(dev_info->name) - 1);
			dev_info->name[sizeof(dev_info->name) - 1] = '\0';
			if (was_address) {
				log("Captured name for device: %s (%s)\n", dev_info->name, dev);
			}
		}
		dev_info->last_seen = now;
		dev_info->svc_mask |= parse_ctx.svc_mask;
		dev_info->has_battery_service = dev_info->has_battery_service || parse_ctx.has_battery_service;
		dev_info->rssi = rssi;  /* Update RSSI from latest advertisement */
		/* Check if device is saved */
		dev_info->is_saved = nvs_is_device_saved(&dev_info->addr);
	} else if (!found) {
		/* Only track saved devices, or any device during scan window */
		bool is_saved = nvs_is_device_saved(addr);
		
		/* Outside scan window: only track saved devices */
		if (!scan_window_active && !is_saved) {
			return;
		}
		
		/* During scan window: track devices with relevant services */
		if (scan_window_active && parse_ctx.svc_mask == 0 && !is_saved) {
			/* Skip devices without HR/CP/FTMS services */
			return;
		}
		
		dev_info = k_malloc(sizeof(struct device_info));
		if (dev_info) {
			memcpy(&dev_info->addr, addr, sizeof(bt_addr_le_t));
			if (parse_ctx.name[0] != '\0') {
				strncpy(dev_info->name, parse_ctx.name, sizeof(dev_info->name) - 1);
				dev_info->name[sizeof(dev_info->name) - 1] = '\0';
			} else {
				strncpy(dev_info->name, dev, sizeof(dev_info->name) - 1);
				dev_info->name[sizeof(dev_info->name) - 1] = '\0';
			}
			dev_info->svc_mask = parse_ctx.svc_mask;
			dev_info->has_battery_service = parse_ctx.has_battery_service;
			dev_info->battery_level = -1;
			dev_info->last_seen = now;
			dev_info->is_saved = is_saved;
			dev_info->rssi = rssi;  /* Store RSSI from advertisement */
			sys_slist_append(&device_list, &dev_info->node);
			log("Added device: %s (svc_mask=%d, saved=%d)\n", dev_info->name, dev_info->svc_mask, is_saved);
			print_device_list();
		} else {
			log("ERROR: Failed to allocate memory for device %s\n", dev);
			return;
		}
	} else {
		log("ERROR: found=true but dev_info=NULL for %s\n", dev);
		return;
	}

	/* Attempt connection if device has known services */
	if (dev_info && dev_info->svc_mask != 0 && 
	    dev_info->name[0] != '\0' && strcmp(dev_info->name, dev) != 0) {
		
		/* Check if already connected first to avoid spam */
		bool already_connected = false;
		for (int i = 0; i < MAX_CONNECTIONS; i++) {
			if (connections[i].conn) {
				const bt_addr_le_t *conn_addr = bt_conn_get_dst(connections[i].conn);
				if (!bt_addr_le_cmp(conn_addr, addr)) {
					already_connected = true;
					break;
				}
			}
		}

		/* Saved devices can connect anytime; non-saved only during scan window */
		if (!already_connected && !dev_info->is_saved) {
			if (!scan_window_active) {
				/* Skip non-saved devices outside scan window */
				return;
			}
		}

		if (!already_connected) {
			int free_slot = -1;
			for (int i = 0; i < MAX_CONNECTIONS; i++) {
				if (!connections[i].conn) {
					free_slot = i;
					break;
				}
			}

			if (free_slot >= 0) {
				struct bt_le_conn_param *param = BT_LE_CONN_PARAM_DEFAULT;
				int err;

				/* Clear the slot to ensure clean state for new connection */
				memset(&connections[free_slot].subscribe_params, 0, 
				       sizeof(connections[free_slot].subscribe_params));
				memset(&connections[free_slot].service_type, 0,
				       sizeof(connections[free_slot].service_type));
				connections[free_slot].subscribe_count = 0;
				connections[free_slot].discover_service_index = 0;
				connections[free_slot].ftms_control_point_handle = 0;
				connections[free_slot].temp_value_handle = 0;

				err = bt_le_scan_stop();
				if (err) {
					log("Stop LE scan failed (err %d)\n", err);
				} else {
					log("Creating connection to %s (slot %d)\n", dev_info->name, free_slot);
					struct bt_conn_le_create_param create_param = *BT_CONN_LE_CREATE_CONN;
					create_param.options = 0;
					
					err = bt_conn_le_create(&dev_info->addr, &create_param, param, &connections[free_slot].conn);
					if (err) {
						log("Create connection failed (err %d)\n", err);
						connections[free_slot].conn = NULL;
						start_scan();
					} else {
						pending_conn = bt_conn_ref(connections[free_slot].conn);
						k_work_schedule(&conn_timeout_work, K_SECONDS(10));
					}
				}
			}
		}
	}

	/* Clean up old devices */
	struct device_info *next;
	SYS_SLIST_FOR_EACH_CONTAINER_SAFE(&device_list, dev_info, next, node) {
		bool is_connected = false;
		for (int i = 0; i < MAX_CONNECTIONS; i++) {
			if (connections[i].conn) {
				const bt_addr_le_t *conn_addr = bt_conn_get_dst(connections[i].conn);
				if (!bt_addr_le_cmp(conn_addr, &dev_info->addr)) {
					is_connected = true;
					dev_info->last_seen = now;
					break;
				}
			}
		}
		
		/* Remove devices not seen in 10 seconds, unless connected */
		if (now - dev_info->last_seen > 10000) {
			if (!is_connected) {
				log("Removed device: %s\n", dev_info->name);
				print_device_list();
				sys_slist_find_and_remove(&device_list, &dev_info->node);
				k_free(dev_info);
			}
		}
	}
}

static void _start_scan_internal(void)
{
	int err;

	struct bt_le_scan_param scan_param = {
		.type       = BT_LE_SCAN_TYPE_ACTIVE,
		.options    = BT_LE_SCAN_OPT_CODED,
		.interval   = BT_GAP_SCAN_FAST_INTERVAL,
		.window     = BT_GAP_SCAN_FAST_WINDOW,
	};

	err = bt_le_scan_start(&scan_param, device_found);
	if (err) {
		if (err == -EALREADY) {
			return;
		}
		log("Scanning with Coded PHY support failed (err %d)\n", err);

		log("Scanning without Coded PHY\n");
		scan_param.options &= ~BT_LE_SCAN_OPT_CODED;
		err = bt_le_scan_start(&scan_param, device_found);
		if (err && err != -EALREADY) {
			log("Scanning failed to start (err %d)\n", err);
			return;
		}
	}

	if (scan_window_active) {
		log("Scanning successfully started (window active)\n");
	} else {
		log("Scanning successfully started\n");
	}
}

void start_scan(void)
{
	_start_scan_internal();
}

void start_advertising(const char *device_name)
{
	int err;
	
	/* Stop scanning first to free up resources for advertising */
	err = bt_le_scan_stop();
	if (err && err != -EALREADY) {
		log("Failed to stop scan for advertising (err %d)\n", err);
	}
	
	/* Stop advertising first if it's already running */
	err = bt_le_adv_stop();
	if (err && err != -EALREADY) {
		log("Failed to stop advertising (err %d)\n", err);
	}
	
	struct bt_data ad[] = {
		BT_DATA_BYTES(BT_DATA_FLAGS, (BT_LE_AD_GENERAL | BT_LE_AD_NO_BREDR)),
		BT_DATA_BYTES(BT_DATA_UUID16_ALL,
			BT_BYTES_LIST_LE16(BT_UUID_HRS_VAL),
			BT_BYTES_LIST_LE16(0x1816),
			BT_BYTES_LIST_LE16(0x1818),
			BT_BYTES_LIST_LE16(0x1826)),
		BT_DATA(BT_DATA_NAME_COMPLETE, (unsigned char *)device_name, strlen(device_name)),
	};

	struct bt_le_adv_param adv_param = {
		.options = BT_LE_ADV_OPT_CONN,
		.interval_min = BT_GAP_ADV_FAST_INT_MIN_1,
		.interval_max = BT_GAP_ADV_FAST_INT_MAX_1,
	};

	err = bt_le_adv_start(&adv_param, ad, ARRAY_SIZE(ad), NULL, 0);
	if (err) {
		log("Advertising failed to start (err %d)\n", err);
		/* If advertising failed, restart scanning */
		start_scan();
		return;
	}

	log("Advertising as '%s' started\n", device_name);
	
	/* Restart scanning so saved devices can reconnect while advertising */
	start_scan();
}

static void scan_window_timeout_handler(struct k_work *work)
{
	log("Scan window expired - resuming normal scanning\n");
	scan_window_active = false;
	
	/* Update LED feedback for scan window end */
	led_feedback_update();
	
	/* Restart scanning to allow saved devices to reconnect normally */
	start_scan();
}

void start_scan_window(uint32_t duration_ms)
{
	scan_window_active = true;
	log("Scan window started for %u ms\n", duration_ms);
	
	/* Update LED feedback for scan window start */
	led_feedback_update();

	/* Schedule timeout to close window */
	k_work_reschedule_for_queue(&k_sys_work_q, &scan_window_timeout,
	                           K_MSEC(duration_ms));

	/* Start scanning immediately */
	_start_scan_internal();
}

void stop_scan_window(void)
{
	if (scan_window_active) {
		int err = bt_le_scan_stop();
		if (err && err != -EALREADY) {
			log("Failed to stop scan (err %d)\n", err);
		}
		k_work_cancel_delayable(&scan_window_timeout);
		scan_window_active = false;
		
		/* Update LED feedback for scan window stop */
		led_feedback_update();
		
		log("Scan window stopped\n");
	}
}

bool is_scan_window_active(void)
{
	return scan_window_active;
}

void disconnect_all_devices(void)
{
	for (int i = 0; i < MAX_CONNECTIONS; i++) {
		if (connections[i].conn) {
			char addr[BT_ADDR_LE_STR_LEN];
			bt_addr_le_to_str(bt_conn_get_dst(connections[i].conn), addr, sizeof(addr));
			log("Disconnecting device: %s\n", addr);
			bt_conn_disconnect(connections[i].conn, BT_HCI_ERR_REMOTE_USER_TERM_CONN);
		}
	}
}

void save_connected_device(struct bt_conn *conn)
{
	/* Find device in list */
	const bt_addr_le_t *addr = bt_conn_get_dst(conn);
	struct device_info *dev_info;
	
	SYS_SLIST_FOR_EACH_CONTAINER(&device_list, dev_info, node) {
		if (!bt_addr_le_cmp(&dev_info->addr, addr)) {
			/* Save device to NVS if not already saved */
			if (!dev_info->is_saved) {
				int err = nvs_save_device(&dev_info->addr, dev_info->name, dev_info->svc_mask);
				if (err == 0) {
					dev_info->is_saved = true;
					log("Auto-saved connected device: %s\n", dev_info->name);
				} else {
					log("Failed to save device %s (err %d)\n", dev_info->name, err);
				}
			}
			break;
		}
	}
}

void device_manager_init(void)
{
	sys_slist_init(&device_list);
	k_work_init_delayable(&conn_timeout_work, conn_timeout_handler);
	k_work_init_delayable(&scan_window_timeout, scan_window_timeout_handler);
	
	/* Initialize NVS storage */
	int err = nvs_storage_init();
	if (err) {
		log("Failed to initialize NVS storage (err %d)\n", err);
	} else {
		/* Load saved devices */
		struct saved_device saved[MAX_SAVED_DEVICES];
		int count = nvs_load_devices(saved, MAX_SAVED_DEVICES);
		log("Loaded %d saved device(s) from NVS\n", count);
		for (int i = 0; i < count; i++) {
			if (saved[i].valid) {
				char addr_str[BT_ADDR_LE_STR_LEN];
				bt_addr_le_to_str(&saved[i].addr, addr_str, sizeof(addr_str));
				log("  [%d] %s (%s) svc_mask=%d\n", i, saved[i].name, addr_str, saved[i].svc_mask);
			}
		}
	}
	
	/* Always start scanning - saved devices can reconnect anytime */
	start_scan();
}
```

## src/device_manager.h
```c
/* device_manager.h - Device list and scanning */

#ifndef DEVICE_MANAGER_H_
#define DEVICE_MANAGER_H_

#include <zephyr/bluetooth/bluetooth.h>

/* Device list */
extern sys_slist_t device_list;

/* Functions */
void device_manager_init(void);
void print_device_list(void);
void start_scan(void);
void start_advertising(const char *device_name);
void cancel_connection_timeout(struct bt_conn *conn);
void save_connected_device(struct bt_conn *conn);

/* Scanning window control */
void start_scan_window(uint32_t duration_ms);
void stop_scan_window(void);
bool is_scan_window_active(void);

/* Disconnect all devices */
void disconnect_all_devices(void);

#endif /* DEVICE_MANAGER_H_ */
```

## src/ftms_control_point.c
```c
/* ftms_control_point.c - FTMS Control Point handling */

#include <zephyr/kernel.h>
#include <zephyr/bluetooth/bluetooth.h>
#include <zephyr/bluetooth/gatt.h>
#include <zephyr/sys/byteorder.h>
#include <string.h>
#include "common.h"
#include "ftms_control_point.h"
#include "gatt_services.h"

/* Control Point state */
bool ftms_cp_indicate_enabled = false;
bool ftms_cp_indicating = false;

/* Grade to resistance conversion: grade -100 -> 0, grade 1900 -> 100 */
#define GRADE_RESISTANCE(x) MAX(MIN(((x) + 120) / 20, 100), 0)

/* Track if last command was converted from 0x11 to 0x04 */
static bool last_cmd_was_converted = false;

/* Buffer for Control Point indication responses */
static uint8_t ftms_cp_response[20];
static uint16_t ftms_cp_response_len;
static struct bt_gatt_indicate_params ftms_cp_ind_params;

/* Buffer for forwarding commands to trainer */
static uint8_t ftms_cp_write_buf[32];
static struct bt_gatt_write_params ftms_cp_write_params;
static bool ftms_cp_write_busy = false;

/* Work item for sending deferred Control Point responses */
struct k_work ftms_cp_response_work;

const char *ftms_cp_opcode_str(uint8_t opcode)
{
	switch (opcode) {
	case FTMS_CP_REQUEST_CONTROL:        return "Request Control";
	case FTMS_CP_RESET:                  return "Reset";
	case FTMS_CP_SET_TARGET_SPEED:       return "Set Target Speed";
	case FTMS_CP_SET_TARGET_INCLINATION: return "Set Target Inclination";
	case FTMS_CP_SET_TARGET_RESISTANCE:  return "Set Target Resistance";
	case FTMS_CP_SET_TARGET_POWER:       return "Set Target Power";
	case FTMS_CP_SET_TARGET_HEARTRATE:   return "Set Target Heart Rate";
	case FTMS_CP_START_RESUME:           return "Start/Resume";
	case FTMS_CP_STOP_PAUSE:             return "Stop/Pause";
	case FTMS_CP_SET_INDOOR_BIKE_SIM:    return "Set Indoor Bike Simulation";
	case FTMS_CP_RESPONSE_CODE:          return "Response Code";
	default:                             return "Unknown";
	}
}

void ftms_cp_ccc_cfg_changed(const struct bt_gatt_attr *attr, uint16_t value)
{
	ftms_cp_indicate_enabled = (value == BT_GATT_CCC_INDICATE);
	log("[FTMS CP] CCC changed: indications %s\n", 
	       ftms_cp_indicate_enabled ? "enabled" : "disabled");
}

static void ftms_cp_indicate_cb(struct bt_conn *conn,
				struct bt_gatt_indicate_params *params, uint8_t err)
{
	if (err) {
		log("[FTMS CP] Indication failed (err %d)\n", err);
	} else {
		log("[FTMS CP] Indication acknowledged by Zwift\n");
	}
}

static void ftms_cp_indicate_destroy(struct bt_gatt_indicate_params *params)
{
	log("[FTMS CP] Indication complete\n");
	ftms_cp_indicating = false;
}

static void ftms_cp_response_work_handler(struct k_work *work)
{
	if (peripheral_conn && ftms_cp_indicate_enabled && !ftms_cp_indicating) {
		/* Use Attribute 11 (Control Point Value) for indication */
		ftms_cp_ind_params.attr = &ftms_svc.attrs[11];
		ftms_cp_ind_params.func = ftms_cp_indicate_cb;
		ftms_cp_ind_params.destroy = ftms_cp_indicate_destroy;
		ftms_cp_ind_params.data = ftms_cp_response;
		ftms_cp_ind_params.len = ftms_cp_response_len;
		
		int err = bt_gatt_indicate(peripheral_conn, &ftms_cp_ind_params);
		if (err) {
			log("[FTMS CP] Failed to send indication (err %d)\n", err);
		} else {
			ftms_cp_indicating = true;
			log("[FTMS CP] Indication sent, waiting for ACK\n");
		}
	}
}

static void ftms_cp_write_cb(struct bt_conn *conn, uint8_t err,
			     struct bt_gatt_write_params *params)
{
	ftms_cp_write_busy = false;
	
	if (err) {
		log("[FTMS CP] Forwarding to trainer failed (err %u)\n", err);
	} else {
		log("[FTMS CP] Forwarding to trainer complete\n");
	}
}

ssize_t ftms_control_point_write(struct bt_conn *conn, const struct bt_gatt_attr *attr,
				 const void *buf, uint16_t len, uint16_t offset, uint8_t flags)
{
	const uint8_t *cmd = buf;
	char addr[BT_ADDR_LE_STR_LEN];

	if (offset != 0) {
		return BT_GATT_ERR(BT_ATT_ERR_INVALID_OFFSET);
	}

	if (len < 1) {
		return BT_GATT_ERR(BT_ATT_ERR_INVALID_ATTRIBUTE_LEN);
	}

	bt_addr_le_to_str(bt_conn_get_dst(conn), addr, sizeof(addr));

	/* Keep debug log for all commands */
	log("[FTMS CP] Zwift (%s) -> %s (0x%02x)\n", 
	       addr, ftms_cp_opcode_str(cmd[0]), cmd[0]);

	/* Store peripheral connection for sending responses back */
	if (!peripheral_conn) {
		peripheral_conn = bt_conn_ref(conn);
		log("[FTMS CP] Stored peripheral connection\n");
	}

	/* Convert Set Indoor Bike Simulation (0x11) to Set Target Resistance (0x04) */
	uint8_t converted_cmd[32];
	const uint8_t *forward_cmd = cmd;
	uint16_t forward_len = len;
	last_cmd_was_converted = false;
	
	if (cmd[0] == FTMS_CP_SET_INDOOR_BIKE_SIM && len >= 5) {
		int16_t wind_speed = sys_le16_to_cpu(*(uint16_t *)&cmd[1]);
		int16_t grade = sys_le16_to_cpu(*(uint16_t *)&cmd[3]);
		
		/* Convert grade (0.01% units) to resistance (unitless 0-100) */
		int16_t resistance = GRADE_RESISTANCE(grade);
		
		/* Build Set Target Resistance command */
		converted_cmd[0] = FTMS_CP_SET_TARGET_RESISTANCE;
		converted_cmd[1] = (uint8_t)resistance;
		forward_cmd = converted_cmd;
		forward_len = 2;
		last_cmd_was_converted = true;
		
		/* Log conversion */
		uint32_t now = k_uptime_get_32();
		json_out("{\"type\":\"sim\",\"ts\":%u,\"wind_speed\":%d,\"grade\":%d,\"resistance\":%d}\n",
		       now, wind_speed, grade, resistance);
		log("[FTMS CP] Converted 0x11 (grade=%d) -> 0x04 (resistance=%d)\n", grade, resistance);
	}

	/* Find trainer connection with FTMS Control Point */
	struct conn_slot *trainer_slot = NULL;
	for (int i = 0; i < MAX_CONNECTIONS; i++) {
		if (connections[i].conn && connections[i].ftms_control_point_handle != 0) {
			trainer_slot = &connections[i];
			log("[FTMS CP] Found trainer at slot %d, handle=%u\n", i, connections[i].ftms_control_point_handle);
			break;
		}
	}

	if (!trainer_slot) {
		char slots_str[64];
		int pos = 0;
		for (int i = 0; i < MAX_CONNECTIONS; i++) {
			if (connections[i].conn) {
				pos += snprintf(slots_str + pos, sizeof(slots_str) - pos, "%d:handle=%u ", i, connections[i].ftms_control_point_handle);
			}
		}
		log("[FTMS CP] ERROR: No trainer connection found (slots: %s)\n", slots_str);
		return len;
	}

	/* Forward command to trainer */
	if (len > sizeof(ftms_cp_write_buf)) {
		log("[FTMS CP] Error: Command too long (%u)\n", len);
		return len;
	}
	
	/* Check if a write is already in progress */
	if (ftms_cp_write_busy) {
		log("[FTMS CP] Write busy, dropping command\n");
		return len;
	}

	memcpy(ftms_cp_write_buf, forward_cmd, forward_len);
			
	ftms_cp_write_params.func = ftms_cp_write_cb;
	ftms_cp_write_params.handle = trainer_slot->ftms_control_point_handle;
	ftms_cp_write_params.offset = 0;
	ftms_cp_write_params.data = ftms_cp_write_buf;
	ftms_cp_write_params.length = forward_len;

	ftms_cp_write_busy = true;
	int err = bt_gatt_write(trainer_slot->conn, &ftms_cp_write_params);
	if (err) {
		ftms_cp_write_busy = false;
		log("[FTMS CP] Write to trainer failed (err %d)\n", err);
	} else {
		char hex_str[96];
		int pos = 0;
		for (int i = 0; i < forward_len && pos < sizeof(hex_str) - 3; i++) {
			pos += snprintf(hex_str + pos, sizeof(hex_str) - pos, "%02x ", forward_cmd[i]);
		}
		log("[FTMS CP] Forwarded to trainer [%u bytes]: %s\n", forward_len, hex_str);
	}

	return len;
}

uint8_t ftms_cp_indicate_func(struct bt_conn *conn,
			      struct bt_gatt_subscribe_params *params,
			      const void *data, uint16_t length)
{
	if (!data) {
		log("[FTMS CP] Indication unsubscribed\n");
		params->value_handle = 0U;
		return BT_GATT_ITER_STOP;
	}

	const uint8_t *response = data;

	/* Log trainer response */
	char hex_str[64];
	int pos = 0;
	for (int i = 0; i < length && pos < sizeof(hex_str) - 3; i++) {
		pos += snprintf(hex_str + pos, sizeof(hex_str) - pos, "%02x ", response[i]);
	}
	log("[FTMS CP] Trainer response [%u bytes]: %s\n", length, hex_str);

	if (length >= 3 && response[0] == FTMS_CP_RESPONSE_CODE) {
		uint8_t req_opcode = response[1];
		uint8_t result = response[2];
		log("[FTMS CP] Response to %s: %s\n",
		       ftms_cp_opcode_str(req_opcode),
		       result == 0x01 ? "Success" : result == 0x02 ? "Not Supported" :
		       result == 0x03 ? "Invalid Parameter" : result == 0x04 ? "Failed" : "Unknown");
	}

	/* Forward indication back to Zwift if connected */
	if (peripheral_conn && ftms_cp_indicate_enabled) {
		if (length > sizeof(ftms_cp_response)) {
			log("[FTMS CP] Response too long (%u), truncating\n", length);
			length = sizeof(ftms_cp_response);
		}
		ftms_cp_response_len = length;
		memcpy(ftms_cp_response, data, length);
		
		/* Convert response opcode from 0x04 back to 0x11 if needed */
		if (last_cmd_was_converted && ftms_cp_response_len >= 3 && 
		    ftms_cp_response[0] == FTMS_CP_RESPONSE_CODE && 
		    ftms_cp_response[1] == FTMS_CP_SET_TARGET_RESISTANCE) {
			ftms_cp_response[1] = FTMS_CP_SET_INDOOR_BIKE_SIM;
			log("[FTMS CP] Converted response 0x04 -> 0x11 for Zwift\n");
			last_cmd_was_converted = false;
		}
		
		k_work_submit(&ftms_cp_response_work);
		log("[FTMS CP] Queued response for forwarding\n");
	} else if (peripheral_conn && !ftms_cp_indicate_enabled) {
		log("[FTMS CP] Cannot send indication - CCC not configured\n");
	}

	return BT_GATT_ITER_CONTINUE;
}

void ftms_control_point_init(void)
{
	k_work_init(&ftms_cp_response_work, ftms_cp_response_work_handler);
}
```

## src/ftms_control_point.h
```c
/* ftms_control_point.h - FTMS Control Point handling */

#ifndef FTMS_CONTROL_POINT_H_
#define FTMS_CONTROL_POINT_H_

#include <zephyr/bluetooth/gatt.h>
#include <zephyr/bluetooth/conn.h>

/* FTMS Control Point Op Codes */
#define FTMS_CP_REQUEST_CONTROL           0x00
#define FTMS_CP_RESET                     0x01
#define FTMS_CP_SET_TARGET_SPEED          0x02
#define FTMS_CP_SET_TARGET_INCLINATION    0x03
#define FTMS_CP_SET_TARGET_RESISTANCE     0x04
#define FTMS_CP_SET_TARGET_POWER          0x05
#define FTMS_CP_SET_TARGET_HEARTRATE      0x06
#define FTMS_CP_START_RESUME              0x07
#define FTMS_CP_STOP_PAUSE                0x08
#define FTMS_CP_SET_INDOOR_BIKE_SIM       0x11
#define FTMS_CP_RESPONSE_CODE             0x80

/* Control Point state */
extern bool ftms_cp_indicate_enabled;
extern bool ftms_cp_indicating;
extern struct k_work ftms_cp_response_work;

/* Functions */
void ftms_control_point_init(void);
const char *ftms_cp_opcode_str(uint8_t opcode);

/* GATT callbacks */
void ftms_cp_ccc_cfg_changed(const struct bt_gatt_attr *attr, uint16_t value);
ssize_t ftms_control_point_write(struct bt_conn *conn, const struct bt_gatt_attr *attr,
				 const void *buf, uint16_t len, uint16_t offset, uint8_t flags);

/* Indication callback for Control Point responses from trainer */
uint8_t ftms_cp_indicate_func(struct bt_conn *conn,
			      struct bt_gatt_subscribe_params *params,
			      const void *data, uint16_t length);

#endif /* FTMS_CONTROL_POINT_H_ */
```

## src/gatt_discovery.h
```c
/* gatt_discovery.h - GATT service/characteristic discovery */

#ifndef GATT_DISCOVERY_H_
#define GATT_DISCOVERY_H_

#include <zephyr/bluetooth/gatt.h>
#include <zephyr/bluetooth/conn.h>

/* Discovery callback */
uint8_t discover_func(struct bt_conn *conn,
		      const struct bt_gatt_attr *attr,
		      struct bt_gatt_discover_params *params);

void start_discovery(struct bt_conn *conn, int slot_idx);
void start_battery_level_check(struct bt_conn *conn, int slot_idx);

#endif /* GATT_DISCOVERY_H_ */
```

## src/led_feedback.c
```c
/* led_feedback.c - LED feedback for user status indication */

#include <zephyr/kernel.h>
#include <zephyr/drivers/gpio.h>
#include "common.h"
#include "led_feedback.h"
#include "device_manager.h"

/* LED configuration - use led0 alias from devicetree */
#define LED0_NODE DT_ALIAS(led0)

#if DT_NODE_HAS_STATUS(LED0_NODE, okay)
static const struct gpio_dt_spec led = GPIO_DT_SPEC_GET(LED0_NODE, gpios);
static bool led_available = true;
#else
/* Fallback if no LED defined in devicetree */
static bool led_available = false;
static struct gpio_dt_spec led;
#endif

/* LED pattern state machine */
enum led_mode {
	LED_MODE_IDLE,           /* No devices connected, slow single blink */
	LED_MODE_PAIRING,        /* Scan window active, slow steady blink */
	LED_MODE_CONNECTED,      /* N devices connected, N blinks then pause */
};

static enum led_mode current_mode = LED_MODE_IDLE;
static int blink_count = 0;           /* Current blink within sequence */
static int target_blinks = 0;         /* Number of blinks for connected devices */
static bool led_on = false;           /* Current LED state */

/* Timer for LED pattern */
static struct k_work_delayable led_work;

/* Timing constants (in milliseconds) */
#define PAIRING_BLINK_ON_MS      500    /* Slow blink during pairing */
#define PAIRING_BLINK_OFF_MS     500

#define CONNECTED_BLINK_ON_MS    100    /* Quick pulse for connection count */
#define CONNECTED_BLINK_OFF_MS   200
#define CONNECTED_PAUSE_MS       1200   /* Pause between blink groups */

#define IDLE_BLINK_ON_MS         150    /* Brief pulse when idle */
#define IDLE_BLINK_OFF_MS        2500   /* Long off period when idle */

static void set_led(bool on)
{
	if (!led_available) {
		return;
	}
	led_on = on;
	/* LEDs are often active-low, but GPIO_DT_SPEC handles this via flags */
	gpio_pin_set_dt(&led, on ? 1 : 0);
}

int led_feedback_get_connection_count(void)
{
	int count = 0;
	for (int i = 0; i < MAX_CONNECTIONS; i++) {
		if (connections[i].conn != NULL) {
			count++;
		}
	}
	return count;
}

static void led_work_handler(struct k_work *work)
{
	uint32_t next_delay_ms = 0;
	
	/* Check if we should be in pairing mode */
	if (is_scan_window_active()) {
		current_mode = LED_MODE_PAIRING;
	} else {
		int conn_count = led_feedback_get_connection_count();
		if (conn_count == 0) {
			current_mode = LED_MODE_IDLE;
		} else {
			current_mode = LED_MODE_CONNECTED;
			target_blinks = conn_count;
		}
	}
	
	switch (current_mode) {
	case LED_MODE_PAIRING:
		/* Simple toggle for pairing mode */
		if (led_on) {
			set_led(false);
			next_delay_ms = PAIRING_BLINK_OFF_MS;
		} else {
			set_led(true);
			next_delay_ms = PAIRING_BLINK_ON_MS;
		}
		break;
		
	case LED_MODE_IDLE:
		/* Slow single pulse when no devices connected */
		if (led_on) {
			set_led(false);
			next_delay_ms = IDLE_BLINK_OFF_MS;
		} else {
			set_led(true);
			next_delay_ms = IDLE_BLINK_ON_MS;
		}
		break;
		
	case LED_MODE_CONNECTED:
		/* Blink N times for N connected devices, then pause */
		if (led_on) {
			/* LED was on, turn it off */
			set_led(false);
			blink_count++;
			
			if (blink_count >= target_blinks) {
				/* Completed all blinks, long pause */
				blink_count = 0;
				next_delay_ms = CONNECTED_PAUSE_MS;
			} else {
				/* Short pause between blinks */
				next_delay_ms = CONNECTED_BLINK_OFF_MS;
			}
		} else {
			/* LED was off, turn it on */
			set_led(true);
			next_delay_ms = CONNECTED_BLINK_ON_MS;
		}
		break;
	}
	
	/* Schedule next LED update */
	k_work_reschedule(&led_work, K_MSEC(next_delay_ms));
}

void led_feedback_update(void)
{
	if (!led_available) {
		return;
	}
	
	/* Reset pattern state when mode changes */
	blink_count = 0;
	led_on = false;
	set_led(false);
	
	/* Reschedule immediately to pick up new state */
	k_work_reschedule(&led_work, K_NO_WAIT);
}

int led_feedback_init(void)
{
	if (!led_available) {
		log("LED feedback: No LED available in devicetree\n");
		return -ENODEV;
	}
	
	if (!gpio_is_ready_dt(&led)) {
		log("LED feedback: LED device not ready\n");
		led_available = false;
		return -ENODEV;
	}
	
	int err = gpio_pin_configure_dt(&led, GPIO_OUTPUT_INACTIVE);
	if (err < 0) {
		log("LED feedback: Failed to configure LED (err %d)\n", err);
		led_available = false;
		return err;
	}
	
	/* Initialize work item */
	k_work_init_delayable(&led_work, led_work_handler);
	
	log("LED feedback initialized\n");
	
	/* Start LED pattern */
	led_feedback_update();
	
	return 0;
}
```

## src/led_feedback.h
```c
/* led_feedback.h - LED feedback for user status indication */

#ifndef LED_FEEDBACK_H_
#define LED_FEEDBACK_H_

/**
 * Initialize LED feedback module.
 * Must be called after kernel and GPIO are ready.
 * 
 * @return 0 on success, negative errno on failure
 */
int led_feedback_init(void);

/**
 * Update LED feedback state.
 * Call this when connection count or scan window state changes.
 */
void led_feedback_update(void);

/**
 * Get current connected device count (for LED feedback).
 * Counts non-NULL connections in the connection slot array.
 * 
 * @return number of connected devices (0 to MAX_CONNECTIONS)
 */
int led_feedback_get_connection_count(void);

#endif /* LED_FEEDBACK_H_ */
```

## src/nvs_storage.h
```c
/* nvs_storage.h - Non-volatile storage for saved devices */

#ifndef NVS_STORAGE_H_
#define NVS_STORAGE_H_

#include <zephyr/bluetooth/bluetooth.h>
#include "common.h"

/* NVS initialization */
int nvs_storage_init(void);

/* Save a device to NVS (replaces existing entry if addr matches) */
int nvs_save_device(const bt_addr_le_t *addr, const char *name, uint8_t svc_mask);

/* Load all saved devices into memory */
int nvs_load_devices(struct saved_device *devices, int max_devices);

/* Check if a device is saved */
bool nvs_is_device_saved(const bt_addr_le_t *addr);

/* Get saved device info (returns svc_mask, or 0 if not found) */
uint8_t nvs_get_saved_svc_mask(const bt_addr_le_t *addr);

/* Get saved device name (returns NULL if not found) */
const char *nvs_get_saved_name(const bt_addr_le_t *addr);

/* Clear all saved devices */
int nvs_clear_all_devices(void);

/* Get device suffix from unique hardware ID (computed each time, not persisted) */
int nvs_get_device_suffix(char *suffix, int max_len);

#endif /* NVS_STORAGE_H_ */
```
